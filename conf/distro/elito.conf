## meta/conf/distro/elito.conf
```bitbake
#-----------------------------------------------------------------------------
#@TYPE: Distribution
#@NAME: Minimal
#@DESCRIPTION: Embedded Linux Distribution Configuration (minimal)
#
#@COMMENT: This distribution configuration serves as a starting point for
#@COMMENT: the integration of new target platforms, machines, or distributions.
#@COMMENT: It bases on conservative settings and should always be buildable.
#-----------------------------------------------------------------------------

#
# Header
#
DISTRO_NAME          = "ELiTo"
DISTRO_VERSION_MAJOR = "0.93"
MAINTAINER	     = "SIGMA Chemnitz GmbH <elito@sigma-chemnitz.de>"

DISTRO_VERSION	    ?= "${@elito_get_distro_version(d)}"
DISTRO_TYPE	    := "${@['debug','release'][os.environ.get('W','tmp').startswith('release-')]}"
COMMERCIAL_LICENSE  ?= ""

IMAGE_DEV_MANAGER   ?= "udev"
IMAGE_INIT_MANAGER  ?= "systemd"
IMAGE_INITSCRIPTS[vardeps] = "IMAGE_INIT_MANAGER"
IMAGE_INITSCRIPTS   ?= "${@elito_base_switch(d, 'IMAGE_INIT_MANAGER', \
'systemd','elito-systemd-conf', \
'')}"

BB_VERBOSE_LOGS      = "1"

DISTRO_LIBC         ?= "glibc"
DISTRO_ROOTPASSWD  ??= ""
ROOT_HOME	     = "/root"

SRC_DIST_LOCAL	    ?= "symlink"
INHERIT_DISTRO       = "\
	debian devshell sstate license \
	elito"

ELITO_DEPLOY_DIR_IMAGE ?= "${DEPLOY_DIR}/images"
DEPLOY_DIR_IMAGE     = "${ELITO_DEPLOY_DIR_IMAGE}"
ELITO_MAKEFILE_DIR   = "${STAGING_DIR}/m"

IMAGE_FSTYPES ?= "	\
	tar.bz2		\
	${@base_contains('MACHINE_FEATURES','ubifs','ubifs ubi','',d)}	\
	${@base_contains('MACHINE_FEATURES','jffs2','jffs2','',d)}	\
	${@base_contains('MACHINE_FEATURES','arnoldboot','arnoldboot','',d)}	\
"

EXTRA_IMAGE_FEATURES ?= "\
  ${@['','debug-tweaks']['${DISTRO_TYPE}' == 'debug']} \
  ssh-server-dropbear package-management \
  ${@base_contains('DISTRO_FEATURES', 'screen', 'splash', '', d)} \
"
USER_CLASSES	     ?= "rm_work rm_old_work image-prelink"
IMAGE_KEEPROOTFS     ?= "1"

BB_LOCALCOUNT_OVERRIDE = ""
DISABLE_QEMU	     = "true"

QA_LOG		     = "1"
BBMASK_DISTRO     = "(/external-csl-toolchain.*)|(/linux-yocto_.*)|(/recipes-bsp/u-boot/u-boot(_|-mkimage).*)"

ELITO_MIRRORS	 ?= "http://files.andto.de/mirror http://www.sigma-chemnitz.de/dl/elito/sources"
ELITO_MIRRORS[type] = "list"
ELITO_MIRROR	 ?= "${@oe.data.typed_value('ELITO_MIRRORS', d)[0]}"

ELITO_GIT_REPO	 ?= "git://git.sigma-chemnitz.de:443"
ELITO_GIT_WS	 ?= "${ELITO_WORKSPACE_DIR}"
ELITO_CRT	??= ""

export ELITO_CRT

PROJECT_PASSWD_PATCH ?= ""
PROJECT_REPOSITORIES ?= ""

PREMIRRORS[vardeps] += "DL_DIR"
PREMIRRORS_prepend = "${PROJECT_REPOSITORIES} \
 ${@'\n'.join([ \
	".*://.*/.*	file://${DL_DIR}/../local/", \
	"" \
])}"

MIRRORS[vardeps] += "ELITO_MIRRORS"
MIRRORS_prepend = "${PROJECT_REPOSITORIES} \
 ${@'\n' + '\n'.join(reduce(lambda x,y: x + [	\
	'git://.*/.*	%s' % y,	\
	''], oe.data.typed_value('ELITO_MIRRORS', d), []))}"

MIRRORS_append = "\
 ${@'\n' + '\n'.join(reduce(lambda x,y: x + [	\
	'ftp://.*/.*	%s' % y,	\
	'http://.*/.*	%s' % y,	\
	'svn://.*/.*	%s' % y,	\
	'cvs://.*/.*	%s' % y,	\
	'hg://.*/.*	%s' % y,	\
	''], oe.data.typed_value('ELITO_MIRRORS', d), []))}"

PROJECT_FILE_DATE = "${@get_filedate('${PROJECT_TOPDIR}/conf/project.conf')}"
PROJECT_CONF_DATE = "${@max(map(lambda x: \
	(get_filedate(x) or 0), \
	['${PROJECT_TOPDIR}/conf',] + \
	elito_glob('${PROJECT_TOPDIR}/conf/*.conf')))}"

DISTRO_CRYPTOPROVIDERS = "openssl:gnutls:*"

export CCACHE_DIR = "${TMPDIR}/cache/ccache"

#
# Kernel
#
OLDEST_KERNEL		?= "2.6.32"
KERNEL_UIMAGE		 = "1"
KERNEL_BOOT_VARIANT	??= "${@'${KERNEL_IMAGETYPE}'.lower()}"
MACHINE_TASK_PROVIDER	?= "elito-task-core"

KERNEL_CONSOLE		?=  "${@(lambda x: '%s,%sn8' % (x[1],x[0]))('${SERIAL_CONSOLE}'.split())}"

TCLIBC			 = "${DISTRO_LIBC}"
TCLIBCAPPEND		:= ''
PROJECT_FEATURES	?= "modules usb eabi"
PROJECT_FEATURES[type]   = "list"
NO_PROJECT_FEATURES	?= ""
NO_PROJECT_FEATURES[type] = "list"

_ELITO_EXT_PROJECT_FEATURES = "\
  largefile nfsroot modules ld-is-gold ${PROJECT_FEATURES} \
  ${DISTRO_FEATURES_INITMAN} ${DISTRO_FEATURES_LIBC} \
  ${@base_contains('IMAGE_FSTYPES',    'ubifs', 'ubifs mtd', '', d)} \
  ${@base_contains('IMAGE_FSTYPES',    'ubi', 'ubifs mtd', '', d)} \
  ${@base_contains('IMAGE_FSTYPES',    'jffs2', 'jffs2 mtd', '', d)} \
  ${@base_contains('IMAGE_FSTYPES',    'ext2', 'ext2 ext4', '', d)} \
  ${@base_contains('IMAGE_FSTYPES',    'ext4', 'ext2 ext4', '', d)} \
  ${@base_contains('PROJECT_FEATURES', 'alsa', 'sound', '', d)} \
  ${@base_contains('PROJECT_FEATURES', 'directfb', 'screen', '', d)} \
  ${@base_contains('PROJECT_FEATURES', 'fb', 'screen', '', d)} \
  ${@base_contains('PROJECT_FEATURES', 'mmc', 'ext2 vfat', '', d)} \
  ${@base_contains('PROJECT_FEATURES', 'touchscreen', 'screen', '', d)} \
  ${@base_contains('PROJECT_FEATURES', 'ubifs', 'mtd', '', d)} \
  ${@base_contains('PROJECT_FEATURES', 'jffs2', 'mtd', '', d)} \
  ${@base_contains('PROJECT_FEATURES', 'usbclient', 'usb usbgadget', '', d)} \
  ${@base_contains('PROJECT_FEATURES', 'usbgadget', 'usb usbclient', '', d)} \
  ${@base_contains('PROJECT_FEATURES', 'usbhost', 'ext2 vfat', '', d)} \
  ${@base_contains('PROJECT_FEATURES', 'usbhost', 'usb', '', d)} \
  ${@base_contains('PROJECT_FEATURES', 'wayland', 'screen', '', d)} \
  ${@base_contains('PROJECT_FEATURES', 'x11', 'screen', '', d)} \
"
_ELITO_EXT_PROJECT_FEATURES[type] = 'list'

DISTRO_FEATURES[vardeps] += "_ELITO_EXT_PROJECT_FEATURES NO_PROJECT_FEATURES"
DISTRO_FEATURES = "${@' '.join(sorted(list( \
  set(oe.data.typed_value('_ELITO_EXT_PROJECT_FEATURES', d)) - \
  set(oe.data.typed_value('NO_PROJECT_FEATURES', d)))))}"

DISTRO_FEATURES_BACKFILL_CONSIDERED = "${DISTRO_FEATURES_BACKFILL}"

DISTRO_DERIVED_FEATURES  = "\
  ${@base_contains('PROJECT_FEATURES', 'x11', 'gtk-supported', '', d)} \
  ${@base_contains('PROJECT_FEATURES', 'wayland', 'gtk-supported', '', d)} \
"

ELITO_CRYPTO_PROVIDER	?= "openssl"

DISTRO_FEATURES_INITMAN ?= "${IMAGE_INIT_MANAGER}"
BUILD_OPTIMIZATION	+= "-pipe"

PROJECT_EXTRA_RDEPENDS	?= "task-${PROJECT_NAME}"
IMAGE_LINGUAS           ?= "de-de en-gb en-us fr-fr"
DEFAULT_TIMEZONE	?= "Universal"

ELITO_NETWORKD		?= "systemd"

ELITO_COMMON_MACHINE_CONFIGURATION ??= "conf/disto/include/elito-common_none.inc"

#
# Binutils & Compiler
#
PREFERRED_PROVIDER_virtual/libsdl        ?= "libsdl-x11"
PREFERRED_PROVIDER_virtual/libqte2       ?= "qte-mt"
PREFERRED_PROVIDER_virtual/libusb0	 ?= "libusb-compat"
PREFERRED_PROVIDER_virtual/db-native	 ?= "db-native"
PREFERRED_PROVIDER_virtual/db		 ?= "db"
PREFERRED_PROVIDER_virtual/libx11	 ?= "libx11"
PREFERRED_PROVIDER_virtual/libgl	 ?= "mesa-xlib"
PREFERRED_PROVIDER_virtual/xserver	 ?= "xserver-kdrive"

PREFERRED_PROVIDER_avahi		 ?= "avahi"
PREFERRED_PROVIDER_gtk+			 ?= "gtk+"
PREFERRED_PROVIDER_lzo			 ?= "lzo2"
PREFERRED_PROVIDER_lzo-native		 ?= "lzo2-native"
PREFERRED_PROVIDER_u-boot		 ?= "u-boot"

PREFERRED_PROVIDER_virtual/kernel	  = "elito-kernel"

VIRTUAL-RUNTIME_init_manager		  = "${IMAGE_INIT_MANAGER}"

#
# C library
#
PREFERRED_PROVIDER_linux-libc-headers			= "linux-libc-headers"

#
# Bootstrap & Init
#
PREFERRED_PROVIDER_task-bootstrap = "task-bootstrap"

#
# Misc
#
PREFERRED_PROVIDER_gconf ?= "gconf-dbus"
PREFERRED_PROVIDER_jpeg  ?= "libjpeg-turbo"
PREFERRED_PROVIDER_jpeg-native ?= "libjpeg-turbo-native"

TARGET_CPU_pn-gcc-crosssdk-initial ?= ""
TARGET_CPU_pn-gcc-crosssdk-intermediate ?= ""
TARGET_CPU_pn-gcc-crosssdk ?= ""

TARGET_ABI_pn-gcc-crosssdk-initial ?= ""
TARGET_ABI_pn-gcc-crosssdk-intermediate ?= ""
TARGET_ABI_pn-gcc-crosssdk ?= ""

BUILDHISTORY_CHECKVERBACKWARDS ?= "0"
BUILDCFG_VARS += "ELITO_PROJECT_UUID"

#
# Preferred versions
#

BUILD_VENDOR = "-oe"
TARGET_VENDOR = ""

NO32LIBS ?= "1"

require conf/distro/include/elito-signature_${ELITO_SIGNATURE_HANDLER}.inc
include conf/distro/include/elito-initmanager_${IMAGE_INIT_MANAGER}.inc
require conf/distro/include/elito-deps.inc
require conf/distro/include/elito-patches.inc
require conf/distro/include/elito-revs.inc
```

## meta/conf/distro/include/elito-common_mx28.inc
```bitbake
ELITO_COMMON_KERNEL_MODULES-mmc += "\
  kernel-module-mxs-mmc \
"

ELITO_COMMON_KERNEL_MODULES-can += "\
  kernel-module-flexcan \
"

ELITO_COMMON_KERNEL_MODULES-usbhost += "\
  kernel-module-ehci-mxs \
  kernel-module-mxs-phy \
"

ELITO_COMMON_KERNEL_MODULES-usbclient += "\
  kernel-module-fsl-usb2-udc \
  kernel-module-mxs-phy \
"

ELITO_COMMON_KERNEL_MODULES-screen += "\
  kernel-module-pwm-mxs \
"
```

## meta/conf/distro/include/elito-common_mx6.inc
```bitbake
ELITO_COMMON_KERNEL_MODULES-can += "\
  kernel-module-flexcan \
"

ELITO_COMMON_KERNEL_MODULES-sound += "\
  kernel-module-snd-soc-fsl-ssi \
  kernel-module-snd-soc-simple-card \
  kernel-module-snd-soc-imx-audmux \
"

ELITO_COMMON_KERNEL_MODULES-usbhost += "\
  kernel-module-phy-mxs-usb \
  kernel-module-ci-hdrc-imx \
  kernel-module-usbmisc-imx \
"

ELITO_COMMON_KERNEL_MODULES-core += "\
  kernel-module-imx-thermal \
  kernel-module-rtc-snvs \
"

ELITO_COMMON_KERNEL_MODULES-mmc = "\
  kernel-module-sdhci-esdhc-imx \
"

ELITO_COMMON_KERNEL_MODULES-fb = "\
  kernel-module-parallel-display \
  kernel-module-ci-hdrc-imx \
  kernel-module-imx-ipuv3-crtc \
"

ELITO_COMMON_KERNEL_MODULES-sata = "\
  kernel-module-ahci-imx \
"

ELITO_COMMON_KERNEL_MODULES-v4l = "\
  kernel-module-imx-ipuv3-csi \
"

ELITO_COMMON_DEPENDS-core += "\
  elito-devicetree-tools-cross-${TARGET_ARCH} \
"
```

## meta/conf/distro/include/elito-common_omap3.inc
```bitbake
# -*- python -*-

ELITO_COMMON_KERNEL_MODULES-mmc += "\
  kernel-module-omap-hsmmc \
"

ELITO_COMMON_KERNEL_MODULES-wm97xx += "\
  kernel-module-snd-soc-omap-ac97 \
  kernel-module-snd-soc-wm9712 \
"

ELITO_COMMON_KERNEL_MODULES-core += "\
  kernel-module-omap-wdt \
  kernel-module-omap2-mcspi \
"
```

## meta/conf/distro/include/elito-common_pxa168.inc
```bitbake
## -*- python -*-

ELITO_COMMON_KERNEL_MODULES-alsa += "\
  kernel-module-snd-soc-pxa2xx \
  kernel-module-snd-pxa2xx-ac97 \
"

ELITO_COMMON_KERNEL_MODULES-spi += " \
  kernel-module-spi-pxa2xx \
"

ELITO_COMMON_KERNEL_MODULES-ucb1400 += "\
  kernel-module-snd-pxa2xx-ac97 \
"

ELITO_COMMON_KERNEL_MODULES-usbclient += " \
  kernel-module-mv-udc \
"

ELITO_COMMON_KERNEL_MODULES-core += " \
  kernel-module-pxa168-wdt \
  kernel-module-pxa168-hwmon \
  kernel-module-rtc-pxa \
"
```

## meta/conf/distro/include/elito-common_pxa270.inc
```bitbake
## -*- python -*-

ELITO_COMMON_KERNEL_MODULES-usbhost += "\
  kernel-module-ohci-hcd \
"

ELITO_COMMON_KERNEL_MODULES-usbclient += "\
  kernel-module-pxa27x-udc \
"

ELITO_COMMON_KERNEL_MODULES-mmc += "\
  kernel-module-pxamci \
"

ELITO_COMMON_KERNEL_MODULES-pcmcia += "\
  kernel-module-pxa2xx-base \
"

ELITO_COMMON_KERNEL_MODULES-ac97 += "\
  kernel-module-snd-soc-pxa2xx \
  kernel-module-snd-pxa2xx-ac97 \
"

ELITO_COMMON_DIAGNOSIS_TOOLS-core += "\
  pxaregs270 \
  pxaregs320 \
  kernel-module-pxa2xx-wdt \
"
```

## meta/conf/distro/include/elito-deps.inc
```bitbake
# --*- python -*--

RRECOMMENDS_kernel-module-rt73usb_append = " \
        wireless-tools rt73-firmware	\
        kernel-module-arc4 kernel-module-ecb kernel-module-cryptomgr"

RRECOMMENDS_kernel-module-usb-storage_append = " kernel-module-sd-mod"

RRECOMMENDS_i2c-tools_append		= " kernel-module-i2c-dev"
```

## meta/conf/distro/include/elito-initmanager_systemd.inc
```bitbake
PREFERRED_PROVIDER_udev = "systemd"
PREFERRED_PROVIDER_udev-systemd = "systemd"
PREFERRED_PROVIDER_udev-utils = "systemd"
```
