## conf/distro/include/elito-oldpkg.inc
```bitbake
# --*- python -*--
#######################################

ELITO_OLD_CRUFT = "\
abiword_2.6.8 \
abiword_2.8.1 \
abiword_2.8.2 \
abiword_2.8.3 \
aceofpenguins_1.2 \
acpid_1.0.2 \
acpid_1.0.3 \
acpid_1.0.4 \
acpid_1.0.6 \
acpid_1.0.8 \
aircrack_2.1 \
alsa-lib_1.0.20 \
alsa-plugins_1.0.17 \
alsa-plugins_1.0.18 \
alsa-plugins_1.0.19 \
alsa-utils_1.0.17 \
alsa-utils_1.0.18 \
alsa-utils_1.0.19 \
apache2-native_2.2.3 \
apache2_2.2.3 \
apex-env_1.5.8 \
appweb_1.2.0 \
apr-util_0.9.12 \
apr-util_1.2.12 \
apr-util_1.2.7 \
apr_0.9.12 \
apr_1.2.12 \
apr_1.2.7 \
apr_1.3.3 \
arora-e_0.10.1 \
arora_0.10.1 \
asio_1.1.1 \
aspell_0.60.5 \
asterisk_1.2.24 \
asterisk_1.2.28 \
asterisk_1.4.17 \
asterisk_1.4.19.1 \
asterisk_1.4.23.1 \
at91bootstrap_2.10 \
at91bootstrap_2.11 \
at91bootstrap_2.4 \
at_3.1.8 \
atd_0.70 \
atk_1.18.0 \
atk_1.19.3 \
atk_1.20.0 \
atk_1.26.0 \
atk_1.28.0 \
autoconf_2.61 \
autoconf_2.63 \
autofs_3.1.7 \
autofs_4.0.0 \
automake_1.10.2 \
automake_1.10.3 \
automake_1.9.6 \
avahi-python_0.6.21 \
avahi-ui_0.6.21 \
avahi_0.6.19 \
avahi_0.6.20 \
avahi_0.6.21 \
avahi_0.6.22 \
avahi_0.6.23 \
avahi_0.6.24 \
balsa_2.0.17 \
batmand_0.3 \
bc-cube_0.1.0 \
bind_9.3.1 \
bind_9.3.4-P1 \
bind_9.3.5-P1 \
binutils-canadian-sdk_2.18 \
binutils-cross-sdk_2.14.90.0.6 \
binutils-cross-sdk_2.14.90.0.7 \
binutils-cross-sdk_2.15.94.0.1 \
binutils-cross-sdk_2.16.91.0.6 \
binutils-cross-sdk_2.16.91.0.7 \
binutils-cross-sdk_2.17 \
binutils-cross-sdk_2.17.50.0.12 \
binutils-cross-sdk_2.18 \
binutils-cross-sdk_2.18.50.0.7 \
binutils-cross-sdk_2.19 \
binutils-cross-sdk_2.19.1 \
binutils-cross-sdk_2.19.51.0.3 \
binutils-cross-sdk_2.20 \
binutils-cross_2.14.90.0.6 \
binutils-cross_2.14.90.0.7 \
binutils-cross_2.15.94.0.1 \
binutils-cross_2.16 \
binutils-cross_2.16.1 \
binutils-cross_2.16.91.0.6 \
binutils-cross_2.16.91.0.7 \
binutils-cross_2.17 \
binutils-cross_2.17.50.0.1 \
binutils-cross_2.17.50.0.12 \
binutils-cross_2.17.50.0.5 \
binutils-cross_2.17.50.0.8 \
binutils-cross_2.18 \
binutils-cross_2.18.50.0.7 \
binutils-cross_2.18.atmel.1.0.1 \
binutils-cross_2.19 \
binutils-cross_2.19.1 \
binutils-cross_2.19.51 \
binutils-cross_2.19.51.0.3 \
binutils-cross_2.20 \
binutils-cross_csl-arm-20050416 \
binutils-cross_csl-arm-20050603 \
binutils_2.14.90.0.6 \
binutils_2.14.90.0.7 \
binutils_2.15.94.0.1 \
binutils_2.16 \
binutils_2.16.1 \
binutils_2.16.91.0.6 \
binutils_2.16.91.0.7 \
binutils_2.17 \
binutils_2.17.50.0.1 \
binutils_2.17.50.0.12 \
binutils_2.17.50.0.5 \
binutils_2.17.50.0.8 \
binutils_2.18 \
binutils_2.18.50.0.7 \
binutils_2.18.atmel.1.0.1 \
binutils_2.19 \
binutils_2.19.1 \
binutils_2.19.51 \
binutils_2.19.51.0.3 \
binutils_2.20 \
binutils_csl-arm-20050416 \
binutils_csl-arm-20050603 \
bison_2.0 \
blueman_1.10 \
bluez-cups-backend_3.33 \
bluez-gstreamer-plugin_3.33 \
bluez-libs_3.33 \
bluez-utils-alsa_3.33 \
bluez-utils_3.33 \
bluez4_4.31 \
bluez4_4.41 \
bluez4_4.42 \
bluez4_4.56 \
bluez4_4.59 \
bonnie++_1.03a \
bootmenu_0.6 \
bridge-utils_1.2 \
btscanner_1.0 \
btsco-module_0.41 \
btsco_0.41 \
busybox-static_1.2.1 \
busybox_1.11.3 \
busybox_1.13.2 \
busybox_1.14.3 \
busybox_1.15.3 \
busybox_1.16.2 \
busybox_1.2.1 \
busybox_1.7.2 \
bzip2_1.0.2 \
cacao-native_0.99.3 \
cacao_0.99.3 \
cacaoh-native_0.99.3 \
cairo_1.4.10 \
cairo_1.8.0 \
cairo_1.8.8 \
canutils_3.0.2 \
cbrpager_0.9.14 \
cdstatus_0.96.05 \
check_0.9.2 \
cherokee_0.4.29 \
cherokee_0.5.3 \
cherokee_0.98.0 \
chicken-cross_4.2.10 \
chicken_4.2.10 \
clamav_0.95.3 \
clutter-gtk_0.10.2 \
clutter_1.0.10 \
cmake-native_2.6.4 \
cmake_2.6.4 \
comprec_0.01 \
connman_0.46 \
conserver_8.1.2 \
consolekit_0.3.0 \
coreutils-native_6.0 \
coreutils_6.0 \
cpusage_0.1 \
cups_1.1.23 \
cups_1.2.12 \
cups_1.2.7 \
cups_1.3.8 \
curl_7.19.6 \
cvs_1.12.8 \
cyrus-imapd_2.2.5 \
cyrus-sasl_2.1.17 \
cyrus-sasl_2.1.18 \
dates_0.4.5 \
davfs2_0.2.7 \
db-native_4.3.29 \
db_4.3.29 \
dbus-glib_0.74 \
dbus-glib_0.78 \
dbus-native_1.2.1 \
dbus_1.2.1 \
dbus_1.2.22 \
dbus_1.2.3 \
debianutils_2.17.3 \
debianutils_2.19 \
desktop-file-utils-native_0.14 \
desktop-file-utils_0.15 \
desktop-file-utils_0.3 \
desktop-file-utils_0.6 \
detect-stylus_0.10 \
device-mapper_1.01.04 \
device-mapper_1.01.05 \
devicekit-disks_004 \
devicekit-power_009 \
dhcdbd_1.14 \
dhcp-forwarder_0.6 \
dhcp_3.0.1 \
dhcp_3.0.2 \
dia_0.94+0.95pre3 \
dialog_1.0-20050306 \
dietlibc_0.31 \
directfb-examples_1.0.0 \
directfb_1.0.0 \
directfb_1.1.0 \
directfb_1.1.1 \
directfb_1.2.3 \
directfb_1.2.7 \
directfb_1.2.8 \
directfb_1.4.1 \
distcc_2.11 \
distcc_2.18.3 \
djvulibre_3.5.20 \
dmidecode_2.9 \
dnsmasq-dbus_2.47 \
dnsmasq_2.11 \
dnsmasq_2.15 \
dnsmasq_2.22 \
dnsmasq_2.47 \
dosbox_0.63 \
dosbox_0.70 \
dosfstools_2.11 \
dri2proto_2.1 \
dropbear_0.49 \
dropbear_0.51 \
ebtables_2.0.6 \
eel_2.12.2 \
eel_2.22.2 \
eel_2.24.1 \
eel_2.6.1 \
eglibc-initial_2.11 \
eglibc-initial_2.9 \
eglibc_2.11 \
eglibc_2.9 \
ekiga_3.0.2 \
ekiga_3.1.0 \
ekiga_3.2.0 \
ekiga_3.2.4 \
ekiga_3.2.5 \
elfutils_0.127 \
elfutils_0.131 \
empathy_0.1 \
empathy_0.14 \
empathy_0.4 \
empathy_0.5 \
empathy_2.23.90 \
empathy_2.24.0 \
empathy_2.26.1 \
enchant_1.3.0 \
erlang-native_R11B.1 \
erlang_R11B.1 \
esc-gst_5 \
esc-media_4 \
espgs_7.07.1 \
estardict_0.1 \
estardict_0.2 \
etoys_3.0.2076 \
exo_0.3.4 \
expat_1.95.6 \
expat_1.95.7 \
faad2_2.0 \
fakeroot-native_1.9.6 \
fakeroot_1.9.6 \
fam_2.6.10 \
fbpanel_4.3 \
fbreader_0.10.7 \
fbreader_0.12.1 \
fbreader_0.7.3d \
fbreader_0.7.4q \
fbreader_0.8.2a \
feh_1.2.6 \
feh_1.2.7 \
fetchmail_6.2.3 \
fetchmail_6.2.5 \
ffmpeg_0.4.9-pre1 \
fftw_3.1.2 \
fftwf_3.1.2 \
fftwl_3.1.2 \
file-roller_2.6.1 \
file_4.18 \
file_4.21 \
findutils_4.2.29 \
findutils_4.5.5 \
firefox_1.0.7 \
flac_1.1.0 \
flac_1.1.2 \
flex_2.5.31 \
flite-alsa_1.2 \
flite_1.2 \
flnx_0.17 \
fltk-chess_0.5 \
fltk_1.1.4 \
fltk_1.1.7 \
fltk_1.1.9 \
fontconfig_2.4.1 \
fontconfig_2.6.0 \
forte_0.3 \
freedoom_0.3 \
freetype-native_2.2.1 \
freetype_2.2.1 \
freetype_2.3.6 \
frodo_4.1b \
frotz_2.42 \
frozen-bubble_1.0.0 \
ftdi-eeprom_0.2 \
fuse-module_2.5.3 \
fuse-module_2.6.5 \
fuse-module_2.7.1 \
fuse_2.6.5 \
fuse_2.7.1 \
fuse_2.7.4 \
gail_1.6.6 \
galculator_1.2.3 \
gamin_0.1.8 \
gcalctool_5.28.0 \
gcalctool_5.5.21 \
gcc-cross-initial_3.3.3 \
gcc-cross-initial_3.4.3 \
gcc-cross-initial_3.4.4 \
gcc-cross-initial_4.0.0 \
gcc-cross-initial_4.1.0 \
gcc-cross-initial_4.1.1 \
gcc-cross-initial_4.2.1 \
gcc-cross-initial_4.2.2 \
gcc-cross-initial_4.2.3 \
gcc-cross-initial_4.3.1 \
gcc-cross-initial_4.3.2 \
gcc-cross-initial_4.3.3 \
gcc-cross-initial_4.4.1 \
gcc-cross-initial_4.4.2 \
gcc-cross-initial_csl-arm-2005q3 \
gcc-cross-initial_csl-arm-2006q1 \
gcc-cross-initial_csl-arm-2007q3 \
gcc-cross-initial_csl-arm-2008q1 \
gcc-cross-intermediate_3.3.3 \
gcc-cross-intermediate_3.4.3 \
gcc-cross-intermediate_3.4.4 \
gcc-cross-intermediate_4.0.0 \
gcc-cross-intermediate_4.1.0 \
gcc-cross-intermediate_4.1.1 \
gcc-cross-intermediate_4.2.1 \
gcc-cross-intermediate_4.2.2 \
gcc-cross-intermediate_4.2.3 \
gcc-cross-intermediate_4.3.1 \
gcc-cross-intermediate_4.3.2 \
gcc-cross-intermediate_4.3.3 \
gcc-cross-intermediate_4.4.1 \
gcc-cross-intermediate_4.4.2 \
gcc-cross-intermediate_csl-arm-2005q3 \
gcc-cross-intermediate_csl-arm-2006q1 \
gcc-cross-intermediate_csl-arm-2007q3 \
gcc-cross-intermediate_csl-arm-2008q1 \
gcc-cross-kernel-3.4.4_3.4.4 \
gcc-cross-kernel-3.4.4_csl-arm-2005q3 \
gcc-cross-sdk_3.4.3 \
gcc-cross-sdk_3.4.4 \
gcc-cross-sdk_4.1.0 \
gcc-cross-sdk_4.1.1 \
gcc-cross-sdk_4.2.2 \
gcc-cross-sdk_4.2.3 \
gcc-cross-sdk_4.3.1 \
gcc-cross-sdk_4.3.2 \
gcc-cross-sdk_4.3.3 \
gcc-cross-sdk_4.4.1 \
gcc-cross-sdk_4.4.2 \
gcc-cross-sdk_csl-arm-2007q3 \
gcc-cross_3.3.3 \
gcc-cross_3.4.3 \
gcc-cross_3.4.4 \
gcc-cross_4.0.0 \
gcc-cross_4.1.0 \
gcc-cross_4.1.1 \
gcc-cross_4.2.1 \
gcc-cross_4.2.2 \
gcc-cross_4.2.3 \
gcc-cross_4.3.1 \
gcc-cross_4.3.2 \
gcc-cross_4.3.3 \
gcc-cross_4.4.1 \
gcc-cross_4.4.2 \
gcc-cross_csl-arm-2005q3 \
gcc-cross_csl-arm-2006q1 \
gcc-cross_csl-arm-2007q3 \
gcc-cross_csl-arm-2008q1 \
gcc-cross_csl-arm-2008q3 \
gcc-native_3.4.4 \
gcc_3.3.3 \
gcc_3.4.3 \
gcc_3.4.4 \
gcc_4.0.0 \
gcc_4.1.0 \
gcc_4.1.1 \
gcc_4.2.1 \
gcc_4.2.2 \
gcc_4.2.3 \
gcc_4.3.1 \
gcc_4.3.2 \
gcc_4.3.3 \
gcc_4.4.1 \
gcc_4.4.2 \
gcc_csl-arm-2005q3 \
gcc_csl-arm-2006q1 \
gcc_csl-arm-2007q3 \
gcc_csl-arm-2008q1 \
gd_2.0.21 \
gd_2.0.22 \
gdal_1.3.2 \
gdb-canadian-sdk_6.8 \
gdb-canadian-sdk_7.0 \
gdb-cross-sdk_6.6 \
gdb-cross-sdk_6.8 \
gdb-cross-sdk_7.0 \
gdb-cross_6.3 \
gdb-cross_6.4 \
gdb-cross_6.6 \
gdb-cross_6.7.1 \
gdb-cross_6.8 \
gdb-cross_7.0 \
gdb_6.3 \
gdb_6.4 \
gdb_6.6 \
gdb_6.7.1 \
gdb_6.8 \
gdb_7.0 \
gdbserver_6.6 \
gdbserver_6.7.1 \
gdbserver_6.8 \
gdbserver_7.0 \
geany_0.14 \
gettext_0.14.1 \
gettext_0.17 \
gftp_2.0.18 \
giblib_1.2.3 \
gift_0.11.4 \
gimp_2.3.10 \
gimp_2.3.19 \
gimp_2.3.8 \
gimp_2.4.0 \
gimp_2.5.2 \
gimp_2.6.0 \
gimp_2.6.3 \
gizmod_2.3 \
glib-2.0-native_2.22.1 \
glib-2.0_2.12.12 \
glib-2.0_2.20.3 \
glib-2.0_2.20.4 \
glib-2.0_2.22.1 \
glib-2.0_2.22.4 \
glib-2.0_2.23.6 \
glib-2.0_2.24.0 \
glib-2.0_2.6.4 \
glib-2.0_2.8.6 \
glibc-initial_2.2.5 \
glibc-initial_2.3.2 \
glibc-initial_2.5 \
glibc-initial_2.6.1 \
glibc-initial_2.9 \
glibc_2.2.5 \
glibc_2.3.2 \
glibc_2.3.3 \
glibc_2.3.5+cvs20050627 \
glibc_2.5 \
glibc_2.6.1 \
glibc_2.9 \
glibmm_2.16.2 \
glibmm_2.18.0 \
glibmm_2.21.2 \
glibmm_2.22.1 \
glproto_1.4.10 \
glproto_1.4.9 \
gmailfs_0.7.3 \
gmp-native_4.2.4 \
gmp_4.2.4 \
gmpc_0.11.2 \
gnash-minimal_0.8.2 \
gnash_0.8.0 \
gnash_0.8.1 \
gnash_0.8.2 \
gnash_0.8.3 \
gnash_0.8.4 \
gnash_0.8.5 \
gnokii_0.6.4 \
gnome-mplayer_0.5.3 \
gnome-mplayer_0.9.5 \
gnome-mplayer_0.9.8 \
gnome-mplayer_0.9.9 \
gnome-packagekit_2.27.1 \
gnome-power-manager_2.24.2 \
gnome-python-desktop_2.23.0 \
gnome-python-desktop_2.28.0 \
gnome-vfs_2.22.0 \
gnuchess_5.05 \
gnuplot_4.0.0 \
gnuplot_4.2.4 \
gnuradio_3.1.3 \
gnuradio_3.2.0 \
gnutls_2.8.5 \
gnutls_2.8.6 \
goffice_0.8.1 \
gparted_0.3.3 \
gpe-aerial_0.2.11 \
gpe-aerial_0.2.12 \
gpe-aerial_0.2.13 \
gpe-announce_0.10 \
gpe-announce_0.12 \
gpe-announce_0.13 \
gpe-autostarter_0.11 \
gpe-autostarter_0.6 \
gpe-autostarter_0.7 \
gpe-beam_0.2.3 \
gpe-beam_0.2.6 \
gpe-beam_0.2.7 \
gpe-beam_0.2.8 \
gpe-bluetooth_0.49 \
gpe-bluetooth_0.51 \
gpe-bluetooth_0.52 \
gpe-bluetooth_0.53 \
gpe-bluetooth_0.54 \
gpe-bootsplash_1.13 \
gpe-bootsplash_1.14 \
gpe-calendar_0.72 \
gpe-calendar_0.90 \
gpe-calendar_0.91 \
gpe-clock_0.14 \
gpe-clock_0.20 \
gpe-clock_0.21 \
gpe-clock_0.23 \
gpe-clock_0.24 \
gpe-clock_0.25 \
gpe-conf_0.2.3 \
gpe-conf_0.2.4 \
gpe-conf_0.2.5 \
gpe-conf_0.2.6 \
gpe-conf_0.2.7 \
gpe-contacts_0.45 \
gpe-contacts_0.46 \
gpe-contacts_0.47 \
gpe-dm_0.48 \
gpe-dm_0.50 \
gpe-dm_0.51 \
gpe-edit_0.29 \
gpe-edit_0.31 \
gpe-edit_0.32 \
gpe-filemanager_0.23 \
gpe-filemanager_0.24 \
gpe-filemanager_0.25 \
gpe-filemanager_0.30 \
gpe-lights_0.12 \
gpe-login_0.93 \
gpe-mininet_0.5 \
gpe-mininet_0.6 \
gpe-mixer_0.42 \
gpe-nmf_0.17 \
gpe-nmf_0.19 \
gpe-nmf_0.20 \
gpe-nmf_0.21 \
gpe-ownerinfo_0.23 \
gpe-ownerinfo_0.24 \
gpe-ownerinfo_0.25 \
gpe-ownerinfo_0.26 \
gpe-ownerinfo_0.27 \
gpe-phonepanel_0.7 \
gpe-scap_1.2 \
gpe-scap_1.3 \
gpe-session-scripts_0.67 \
gpe-sketchbook_0.2.8 \
gpe-su_0.18 \
gpe-su_0.19 \
gpe-taskmanager_0.17 \
gpe-taskmanager_0.18 \
gpe-taskmanager_0.19 \
gpe-tetris_0.6-2 \
gpe-theme-clearlooks_0.2 \
gpe-theme-industrial_0.1 \
gpe-timesheet_0.30 \
gpe-timesheet_0.31 \
gpe-today_0.10 \
gpe-todo_0.50 \
gpe-todo_0.51 \
gpe-todo_0.53 \
gpe-todo_0.54 \
gpe-todo_0.55 \
gpe-todo_0.56 \
gpe-what_0.30 \
gpe-what_0.31 \
gpe-what_0.33 \
gpe-what_0.41 \
gpe-what_0.42 \
gpgme_1.0.0 \
gpgme_1.0.3 \
gphoto2_2.4.0 \
gphoto2_2.4.2 \
gphoto2_2.4.4 \
gphoto2_2.4.7 \
gpicview_0.1.5 \
gpm_1.20.1 \
gpsbabel_1.2.5 \
gpsd_2.38 \
gpsd_2.39 \
gpsd_2.90 \
gpsd_2.91 \
gpsd_2.94 \
gpsdrive_2.10pre2 \
grep_2.5 \
grep_2.5.1 \
grip_3.2.0 \
groff_1.19.1 \
gs_8.16 \
gsl_1.10 \
gsoko_0.4.2-gpe5 \
gspcav1_20070110 \
gspcav1_20070508 \
gssdp_0.6.3 \
gst-ffmpeg_0.10.2 \
gst-ffmpeg_0.10.4 \
gst-ffmpeg_0.10.6 \
gst-ffmpeg_0.10.7 \
gst-ffmpeg_0.10.8 \
gst-plugins-bad_0.10.11 \
gst-plugins-bad_0.10.12 \
gst-plugins-bad_0.10.18 \
gst-plugins-bad_0.10.6 \
gst-plugins-bad_0.10.9 \
gst-plugins-base_0.10.17 \
gst-plugins-base_0.10.22 \
gst-plugins-base_0.10.23 \
gst-plugins-base_0.10.25 \
gst-plugins-base_0.10.28 \
gst-plugins-good_0.10.13 \
gst-plugins-good_0.10.14 \
gst-plugins-good_0.10.15 \
gst-plugins-good_0.10.17 \
gst-plugins-good_0.10.21 \
gst-plugins-ugly_0.10.10 \
gst-plugins-ugly_0.10.11 \
gst-plugins-ugly_0.10.14 \
gst-rtsp_0.10.4 \
gstreamer_0.10.17 \
gstreamer_0.10.22 \
gstreamer_0.10.23 \
gstreamer_0.10.25 \
gstreamer_0.10.28 \
gthumb_2.6.9 \
gtk+_2.10.14 \
gtk+_2.14.1 \
gtk+_2.14.2 \
gtk+_2.16.4 \
gtk+_2.16.6 \
gtk+_2.18.0 \
gtk+_2.18.3 \
gtk+_2.18.6 \
gtk+_2.20.0 \
gtk+_2.6.10 \
gtk+extra_2.1.1 \
gtk-engines_2.15.4 \
gtk-engines_2.18.1 \
gtk-engines_2.6.5 \
gtk-engines_2.7.4 \
gtk-xfce-engine_2.4.2 \
gtkhtml-3.8_3.12.3 \
gtkhtml-3.8_3.8.2 \
gtkmathview_0.7.6 \
gtkmm_2.12.7 \
gtkmm_2.14.1 \
gtkmm_2.18.1 \
gtksourceview2_2.6.0 \
gtksourceview2_2.7.3 \
gtksourceview2_2.9.1 \
guile-native_1.8.2 \
gupnp-av_0.2 \
gupnp-av_0.3 \
gupnp-av_0.5.2 \
gupnp-tools_0.7 \
gupnp-vala_0.4 \
gupnp_0.12.4 \
gupnp_0.12.5 \
gupnp_0.13.1 \
hal-info_20070618 \
hal-info_20070831 \
hal-info_20080313 \
hal-info_20080508 \
hal_0.5.11 \
hal_0.5.12 \
hal_0.5.9 \
hal_0.5.9.1 \
haserl_0.8.0 \
haserl_0.9.23 \
havp_0.82 \
hdparm_6.3 \
hdparm_6.6 \
hdparm_6.9 \
helloworld_1.0.0 \
hicolor-icon-theme_0.10 \
hiker_0.9 \
hostap-daemon_0.4.8 \
hostap-daemon_0.5.10 \
hotplug-ng_001 \
howl_0.9.7 \
hydra_4.4 \
i2c-tools_3.0.1 \
ica-bin_8.0 \
icedtea6-native_1.7.3 \
iksemel_1.2 \
imagemagick_6.3.5-10 \
imake_1.0.2 \
inetutils_1.4.2 \
inetutils_1.5 \
inkscape_0.38.1 \
inkscape_0.39 \
inkscape_0.42 \
inkscape_0.43 \
inotify-tools_2.1 \
inotify-tools_3.12 \
iperf_2.0.2 \
iproute2_2.6.18 \
iproute2_2.6.20 \
iproute2_2.6.22 \
iproute2_2.6.29 \
iproute2_2.6.31 \
iproute2_2.6.34 \
ipsec-tools_0.6.6 \
ipsec-tools_0.6.7 \
iptables_1.3.8 \
iptables_1.4.6 \
iptables_1.4.7 \
iptstate_2.2.1 \
ipython_0.9.1 \
irda-utils_0.9.15 \
irssi_0.8.10 \
iscsi-target_0.4.17 \
iw_0.9.18 \
ixp4xx-kernel_2.6.18 \
ixp4xx-kernel_2.6.19 \
ixp4xx-kernel_2.6.20 \
ixp4xx-kernel_2.6.21.6 \
ixp4xx-npe-native_2.1 \
ixp4xx-npe-native_2.3.2 \
ixp4xx-npe_2.1 \
ixp4xx-npe_2.3.2 \
jack_0.103.0 \
jack_0.116.2 \
jamvm-initial_1.4.5 \
jamvm-native_1.5.3 \
jamvm_1.4.5 \
jamvm_1.5.0 \
jamvm_1.5.2 \
jikes_1.21 \
jpeg_6b \
kanatest_0.3.6 \
kazehakase_0.4.5 \
kbproto_1.0.4 \
kismet_2007-01-R1b \
kismet_2007-10-R1 \
konqueror-embedded_20030705 \
konqueror-embedded_20060404 \
lame_3.96.1 \
lcdproc_0.4.5 \
lcdproc_0.4.99+cvs20060123 \
lcdproc_0.5.0 \
lcms_1.13 \
libabenabler_0.1 \
libaio_0.3.103 \
libassuan_0.6.7 \
libassuan_0.9.3 \
libcanberra_0.12 \
libcanberra_0.14 \
libcgicc_3.2.3 \
libcompress-zlib-perl_1.42 \
libconfig_1.3.1 \
libcontactsdb_0.1 \
libcontactsdb_0.3 \
libcontactsdb_0.4 \
libcroco_0.6.0 \
libcroco_0.6.1 \
libdbi_0.7.2 \
libdrm_2.3.0 \
libdrm_2.3.1 \
libdrm_2.4.11 \
libdrm_2.4.17 \
libdrm_2.4.18 \
libdvdread_0.9.6 \
libecj-bootstrap_3.3 \
libecj-bootstrap_3.3.2 \
libecj-bootstrap_3.4 \
libecj-bootstrap_3.4.1 \
libeina_0.96.5 \
libelf_0.8.3 \
libelf_0.8.6 \
liberror-perl_0.17004 \
libetpan_0.46 \
libetpan_0.48 \
libeventdb_0.17 \
libeventdb_0.18 \
libeventdb_0.19 \
libeventdb_0.21 \
libexosip2_2.2.3 \
libffi_2.0+gcc3.4.1 \
libgc_6.5 \
libgc_6.7 \
libgcrypt_1.2.4 \
libgcrypt_1.4.0 \
libgemwidget_0.1 \
libglade_2.0.1 \
libglade_2.4.0 \
libglade_2.4.2 \
libglade_2.5.1 \
libglade_2.6.2 \
libgles-omap3_3.01.00.02 \
libgmime_2.1.7 \
libgnomeui_2.18.1 \
libgpephone_0.3 \
libgpepimc_0.2 \
libgpepimc_0.3 \
libgpepimc_0.4 \
libgpepimc_0.5 \
libgpepimc_0.6 \
libgpepimc_0.8 \
libgpevtype_0.14 \
libgpevtype_0.15 \
libgpevtype_0.16 \
libgpevtype_0.17 \
libgpewidget_0.114 \
libgpewidget_0.115 \
libgpg-error_1.0 \
libgpg-error_1.3 \
libgphoto2_2.4.0 \
libgphoto2_2.4.2 \
libgphoto2_2.4.4 \
libgphoto2_2.4.7 \
libgpod_0.6.0 \
libgsm_1.0.10 \
libgtkstylus_0.1 \
libhtml-parser-perl_3.60 \
libical_0.27 \
libiconv_1.11 \
libiconv_1.12 \
libidn_0.5.19 \
libintl-perl_1.11 \
libintl-perl_1.16 \
libio-zlib-perl_1.04 \
libjson_0.6 \
liblauncher_0.1.8 \
liblauncher_0.3.6 \
liblinebreak_0.9.6 \
libmad_0.15.0b \
libmailwrapper_1.2.3 \
libmatthew_0.7 \
libmicrohttpd_0.4.2 \
libmikmod_3.1.12 \
libmimedir_0.0-20040307 \
libmimedir_0.3.1 \
libmodplug_0.8.4 \
libmpc_0.8.1 \
libmrss_0.17.2 \
libnet-dbus-perl_0.33.5 \
libnet_1.0.2a \
libnetfilter-queue_0.0.13 \
libnfnetlink_0.0.30 \
libnfnetlink_0.0.39 \
libnids_1.18 \
libnotify_0.4.4 \
libnss-mdns_0.9 \
libnxml_0.16 \
libogg_1.0 \
libogg_1.1 \
libogg_1.1.3 \
liboil_0.3.10 \
liboil_0.3.11 \
liboil_0.3.14 \
liboil_0.3.15 \
liboil_0.3.9 \
libomxil-bellagio_0.9.0 \
libomxil-bellagio_0.9.1 \
libopensync-plugin-file_0.18 \
libopensync-plugin-irmc_0.18 \
libopensync-plugin-syncml_0.22 \
libopensync_0.18 \
libopensync_0.20 \
libopensync_0.22 \
libopie2_1.2.3 \
libopieobex0_1.2.3 \
libopietooth1_1.2.3 \
libosip2_2.2.2 \
libpam_0.79 \
libpam_1.0.2 \
libpam_1.1.0 \
libpcap_0.9.3 \
libpcap_0.9.5 \
libpcap_0.9.8 \
libpcap_1.0.0 \
libpciaccess_0.10.9 \
libpthread-stubs_0.1 \
libpthread-stubs_0.2 \
libqpe-opie_1.2.3 \
libqtaux2_1.2.3 \
librecord_0.1 \
librsvg_2.11.1 \
librsvg_2.16.1 \
librsvg_2.22.2 \
librsvg_2.26.0 \
libsamplerate0_0.1.2 \
libschedule_0.14 \
libschedule_0.15 \
libschedule_0.16 \
libsdl-directfb_1.2.9 \
libsdl-gfx_2.0.11 \
libsdl-image_1.2.3 \
libsdl-image_1.2.6 \
libsdl-mixer_1.2.10 \
libsdl-mixer_1.2.6 \
libsdl-mixer_1.2.8 \
libsdl-native_1.2.11 \
libsdl-ttf_2.0.3 \
libsdl-x11_1.2.11 \
libsexy_0.1.10 \
libsexy_0.1.6 \
libsexy_0.1.8 \
libsigc++-1.2_1.2.5 \
libsigc++-2.0_2.0.17 \
libsigc++-2.0_2.0.6 \
libsigc++-2.0_2.2.2 \
libsndfile1_1.0.16 \
libsndfile1_1.0.17 \
libsoundgen_0.3 \
libsoundgen_0.5 \
libsoup_2.2.7 \
libsyncml_0.4.0 \
libsyncml_0.4.6 \
libtelepathy_0.0.53 \
libtelepathy_0.2.0 \
libtheora_0.9+1.0alpha7 \
libtheora_1.0 \
libtinymail_0.0.1 \
libtinymail_0.0.3 \
libtododb_0.07 \
libtododb_0.08 \
libtododb_0.09 \
libtododb_0.10 \
libtool-cross_1.5.10 \
libtool-cross_2.2.6a \
libtool-native_1.5.10 \
libtool-native_2.2.6a \
libtool-sdk_1.5.10 \
libtool-sdk_2.2.6a \
libtool_1.5.10 \
libtool_1.5.6 \
libtool_2.2.6a \
libupnp_1.3.1 \
libusb-compat_0.1.2 \
libusb1_1.0.2 \
libusb1_1.0.6 \
libv4l_0.5.8 \
libversion-perl_0.80 \
libvisual_0.1.3 \
libvncserver_0.9 \
libvorbis_1.0.1 \
libvorbis_1.2.0 \
libvpx_0.9.0 \
libwpd_0.8.4 \
libwpd_0.8.6 \
libx11_1.3.2 \
libxau_1.0.5 \
libxcb_0.9.91 \
libxcb_0.9.92 \
libxcb_0.9.93 \
libxcb_1.0 \
libxcomp_3.2.0-7 \
libxcomposite_0.4.1 \
libxdamage_1.1.2 \
libxext_1.1.1 \
libxfce4menu_4.6.1 \
libxfce4util_4.6.1 \
libxfcegui4_4.6.1 \
libxfixes_4.0.4 \
libxfont_1.4.1 \
libxi_1.3 \
libxine_1.1.16 \
libxml-parser-perl_2.34 \
libxml2_2.7.3 \
libxml2_2.7.6 \
libxrandr_1.2.1 \
libxrender_0.9.5 \
libxsettings-client_0.12 \
libxsettings-client_0.13 \
libxsettings-client_0.14 \
libxsettings-client_0.16 \
libxslt_1.1.21 \
libxslt_1.1.22 \
libxt_1.0.7 \
libyaml_0.1.2 \
libzvbi_0.2.22 \
lighttpd_1.4.18 \
linphone_0.12.2 \
linphone_1.3.99.8 \
linphone_1.5.0 \
linphone_1.6.0 \
linux-davinci_2.6.25 \
linux-davinci_2.6.27 \
linux-davinci_2.6.28 \
linux-dht-walnut_2.6.20 \
linux-dht-walnut_2.6.23 \
linux-efika_2.6.18+2.6.19-rc6 \
linux-efika_2.6.20 \
linux-efika_2.6.20.20 \
linux-epia_2.6.11 \
linux-epia_2.6.12 \
linux-epia_2.6.19.2 \
linux-epia_2.6.8.1 \
linux-geodegx_2.4.24 \
linux-geodelx_2.6.11 \
linux-gumstix_2.6.15 \
linux-h1940_2.6.11-bk1-h1940 \
linux-h1940_2.6.14-h1940 \
linux-h1940_2.6.17-h1940 \
linux-h6300-omap1_2.6.12-rc5 \
linux-h6300-omap1_2.6.14.3 \
linux-h6300-omap1_2.6.16.16 \
linux-handhelds-2.6_2.6.16-hh9 \
linux-handhelds-2.6_2.6.17-hh4 \
linux-handhelds-2.6_2.6.18-hh2 \
linux-handhelds-2.6_2.6.19-hh13 \
linux-handhelds-2.6_2.6.20-hh10 \
linux-handhelds-2.6_2.6.21-hh20 \
linux-hotplug_20040329 \
linux-ixp4xx_2.6.18 \
linux-ixp4xx_2.6.19 \
linux-ixp4xx_2.6.20 \
linux-ixp4xx_2.6.21.7 \
linux-ixp4xx_2.6.23.14 \
linux-ixp4xx_2.6.24.7 \
linux-jlime-jornada6xx_2.6.11 \
linux-jlime-jornada6xx_2.6.17 \
linux-jlime-jornada6xx_2.6.21rc5 \
linux-jlime-jornada6xx_2.6.25 \
linux-jlime-jornada7xx_2.6.17 \
linux-jlime-jornada7xx_2.6.18 \
linux-jlime-jornada7xx_2.6.19rc6 \
linux-kexecboot_2.6.21-hh20 \
linux-kexecboot_2.6.24 \
linux-kexecboot_2.6.26 \
linux-kexecboot_2.6.32 \
linux-libc-headers_2.6.11.1 \
linux-libc-headers_2.6.15.99 \
linux-libc-headers_2.6.18 \
linux-libc-headers_2.6.18+2.6.19-rc1 \
linux-libc-headers_2.6.20 \
linux-libc-headers_2.6.22 \
linux-libc-headers_2.6.23 \
linux-libc-headers_2.6.24 \
linux-libc-headers_2.6.25 \
linux-libc-headers_2.6.29 \
linux-libc-headers_2.6.30 \
linux-libc-headers_2.6.31 \
linux-libc-headers_2.6.32 \
linux-libc-headers_2.6.34 \
linux-libc-headers_2.6.7.0 \
linux-libc-headers_2.6.8.1 \
linux-magicbox_2.6.18.6 \
linux-magicbox_2.6.19.2 \
linux-mainstone_2.6.25 \
linux-mtx-1_2.4.27 \
linux-mtx-1u_2.4.27 \
linux-mtx-2_2.4.27 \
linux-mtx-3_2.6.15 \
linux-mtx-3_2.6.15.4 \
linux-navman_2.6.18 \
linux-neuros_2.6.15 \
linux-nokia800_2.6.18-osso40 \
linux-nokia800_2.6.21-osso71 \
linux-omap-2.6_2.6.9-omap1 \
linux-omap1_2.6.12-rc2 \
linux-omap1_2.6.18-omap1 \
linux-omap1_2.6.19-omap1 \
linux-omap1_2.6.20-omap1 \
linux-omap1_2.6.22-omap1 \
linux-omap1_2.6.23-omap1 \
linux-omap1_2.6.24-omap1 \
linux-omap1_2.6.25-omap1 \
linux-omap_2.6.26 \
linux-rp_2.6.23 \
linux-rp_2.6.24 \
linux-rp_2.6.25+2.6.26-rc4 \
linux-rp_2.6.26 \
linux-rt_2.6.24 \
linux-rt_2.6.25 \
linux-sequoia_2.6.21 \
linux-sun4cdm_2.4.26 \
linux-sun4cdm_2.6.8.1 \
linux-titan-sh4_2.6.21 \
linux-tornado-omap2_2.6.16.16 \
linux-turbostation_2.6.20.2 \
linux-uml_2.4.26 \
linux-uml_2.6.11-rc2-mm1 \
linux-wrap-geode_2.6.17 \
linux-wrt_2.4.20 \
linux-wrt_2.4.30 \
linux-x86_2.6.17.9 \
linux-x86_2.6.20 \
linux-xxs1500_2.4.21 \
linux-z_2.6.20 \
linux_2.6.14 \
linux_2.6.18 \
linux_2.6.20 \
linux_2.6.21 \
linux_2.6.21+2.6.22-rc1 \
linux_2.6.22 \
linux_2.6.22+2.6.23-rc3 \
linux_2.6.22+2.6.23-rc5 \
linux_2.6.23 \
linux_2.6.23+2.6.24-rc5 \
linux_2.6.23+2.6.24-rc6 \
linux_2.6.24 \
linux_2.6.25 \
linux_2.6.26 \
linux_2.6.28 \
linux_2.6.28-rc6 \
linux_2.6.29 \
linux_2.6.29+2.6.30-rc4 \
linux_2.6.29+2.6.30-rc5 \
listres_1.0.1 \
live555_20051005 \
live555_20090602 \
live555_20100409 \
lmbench_2.0.4 \
lmsensors-apps_2.10.1 \
loudmouth_1.0.1 \
loudmouth_1.1.1 \
loudmouth_1.2.2 \
loudmouth_1.3.2 \
ltp_20070228 \
ltp_20080229 \
ltp_20090131 \
luit_1.0.4 \
lvm2_2.01.09 \
lxde-common_0.3.2.1 \
lxmenu-data_0.1 \
lxpanel_0.3.8.1 \
lyx_1.6.1 \
madwifi-ng_r2826-20071105 \
madwifi-ng_r3314-20080131 \
madwifi-ng_r3837-20080802 \
madwifi-ng_r3878-20081204 \
mailx_8.1.2-0.20020411cvs \
mailx_8.1.2-0.20040524cvs \
mainstone-kernel_2.6.11 \
mainstone-kernel_2.6.18 \
make_3.81 \
man-pages_2.41 \
maradns_1.0.39 \
matchbox-applet-inputmanager_0.5 \
matchbox-common_0.8 \
matchbox-common_0.9 \
matchbox-desktop_0.8 \
matchbox-desktop_0.8.1 \
matchbox-desktop_0.9 \
matchbox-panel_0.8 \
matchbox-panel_0.8.1 \
matchbox-panel_0.8.3 \
matchbox-panel_0.9 \
matchbox-panel_0.9.1 \
matchbox-panel_0.9.2 \
matchbox-wm_0.9.5 \
matchbox-wm_1.0 \
matchbox-wm_1.1 \
matchbox_0.8.1 \
matchbox_0.9 \
mc_4.6.0 \
mc_4.6.1 \
mdadm_1.12.0 \
mdadm_2.5.5 \
mdk2_v33 \
mediatomb_0.8+0.9.0-pre \
mediatomb_0.9.0 \
mediatomb_0.9.1 \
memtester_4.0.5 \
memtester_4.0.6 \
menu-cache_0.2.2 \
mesa-dri_7.2 \
mesa-dri_7.4 \
mesa-dri_7.6 \
mesa-xlib_7.2 \
mesa-xlib_7.4 \
mesa-xlib_7.6 \
mesa_7.2 \
mesa_7.4 \
mesa_7.6 \
microwindows_0.90 \
mime-support_3.28 \
mingw-binutils-canadian-cross_2.17.50-20060824-1 \
mingw-binutils-canadian-cross_2.19.1 \
mingw-binutils_2.17.50-20060824-1 \
mingw-binutils_2.19.1 \
minicom_2.1 \
minilite_0.41 \
minilite_0.43 \
minilite_0.44 \
minilite_0.47 \
minilite_0.48 \
minilite_0.49 \
minimix_0.7 \
minimix_0.8 \
module-init-tools_3.2.1 \
module-init-tools_3.2.2 \
monotone-6_0.27 \
monotone-6_0.31 \
monotone-6_0.33 \
monotone-6_0.34 \
mousepad_0.2.13 \
mp3blaster_3.1.3 \
mp3blaster_3.2.0 \
mp3blaster_3.2.3 \
mpd-alsa_0.11.5 \
mpd_0.14.2 \
mpd_0.15 \
mpfr_2.4.2 \
mplayer_0.0+1.0rc1 \
msynctool_0.22 \
mtd-utils-native_1.1.0 \
mtd-utils-native_1.3.1 \
mtd-utils_1.3.1 \
mutt_1.5.15 \
mutt_1.5.4i \
mutt_1.5.9i \
mythplugins_0.22+fixes \
myththemes_0.22+fixes \
mythtv_0.22+fixes \
nano_2.0.7 \
nano_2.0.9 \
nano_2.2.4 \
ncurses_5.4 \
neon_0.25.5 \
net-snmp_5.1.2 \
net-snmp_5.4.1 \
net6_1.2.2 \
netbook-launcher-efl_0.2.3 \
netperf_2.3 \
network-manager-applet_0.6.5 \
network-manager-applet_0.7.1 \
networkmanager-openvpn_0.7.1 \
networkmanager_0.6.6 \
networkmanager_0.7 \
networkmanager_0.7.1.997 \
networkmanager_0.7olpc \
nfs-utils_1.0.6 \
notecase_1.2.6 \
notecase_1.6.9 \
notification-daemon_0.3.6 \
ntp_4.1.2 \
ntp_4.2.0 \
ntpclient_2003_194 \
nxproxy_3.2.0-1 \
nxproxy_3.3.0-2 \
nxssh_3.3.0-1 \
obexd_0.10 \
obexd_0.13 \
obexd_0.15 \
obexd_0.19 \
obexd_0.21 \
obexftp_0.20 \
obexftp_0.22 \
octave_2.1.73 \
octave_2.9.19 \
octave_3.0.0 \
octave_3.0.3 \
olsrd_0.5.3 \
omap3-sgx-modules_1.4.14.2514 \
opal_3.4.4 \
opal_3.5.2 \
opal_3.6.1 \
opal_3.6.2 \
opal_3.6.4 \
opal_3.6.6 \
opal_3.8.0 \
openbmap-logger_0.2.0 \
openntpd_3.7p1 \
openobex_1.2 \
openobex_1.3 \
openscenegraph_2.9.6 \
opensimpad_2.4.25-vrs2-pxa1-jpm1 \
openssh_5.2p1 \
openssl-native_0.9.8m \
openssl_0.9.8m \
openttd_0.6.3 \
opie-aboutapplet_1.2.3 \
opie-addressbook_1.2.3 \
opie-advancedfm_1.2.3 \
opie-alarm_1.2.3 \
opie-appearance_1.2.3 \
opie-aqpkg_1.2.3 \
opie-autorotateapplet_1.2.3 \
opie-backgammon_1.2.3 \
opie-backup_1.2.3 \
opie-bartender_1.2.3 \
opie-batteryapplet_1.2.3 \
opie-bluepin_1.2.3 \
opie-bluetoothapplet_1.2.3 \
opie-bluetoothmanager_1.2.3 \
opie-bounce_1.2.3 \
opie-brightnessapplet_1.2.3 \
opie-button-settings_1.2.3 \
opie-buzzword_1.2.3 \
opie-calculator_1.2.3 \
opie-camera_1.2.3 \
opie-checkbook_1.2.3 \
opie-citytime_1.2.3 \
opie-clipboardapplet_1.2.3 \
opie-clock_1.2.3 \
opie-clockapplet_1.2.3 \
opie-confeditor_1.2.3 \
opie-console_1.2.3 \
opie-datebook-birthdayplugin_1.2.3 \
opie-datebook-chrisholidayplugin_1.2.3 \
opie-datebook-nationalholidayplugin_1.2.3 \
opie-datebook_1.2.3 \
opie-deco-flat_1.2.3 \
opie-deco-liquid_1.2.3 \
opie-deco-polished_1.2.3 \
opie-doctab_1.2.3 \
opie-drawpad_1.2.3 \
opie-dvorak_1.2.3 \
opie-embeddedkonsole_1.2.3 \
oprofile_0.9.3 \
oprofile_0.9.4 \
oprofile_0.9.5 \
orage_4.4.2 \
orbit2_2.14.12 \
orc_0.4.3 \
orc_0.4.4 \
orinoco-modules_0.13e \
orinoco-modules_0.15rc1 \
ortp_0.7.1 \
osb-browser_20050430 \
osb-jscore_20050430 \
osb-nrcit_20050430 \
osb-nrcore_20050430 \
p4_04.2 \
packagekit_0.2.4 \
packagekit_0.4.6 \
packagekit_0.4.8 \
packagekit_0.5.2 \
pango_1.8.2 \
pax-utils_0.1.13 \
pciutils_2.1.11 \
pciutils_2.2.4 \
pcmciautils_010 \
pcmciautils_013 \
pcmciautils_014 \
pcsc-lite_1.4.102 \
perl-native_5.8.8 \
perl_5.8.8 \
phoneme-advanced-foundation_0.0.b87 \
picocom_1.3 \
pidgin_2.5.8 \
pidgin_2.6.5 \
pidgin_2.6.6 \
pixman_0.12.0 \
pixman_0.13.2 \
pixman_0.16.2 \
pixman_0.17.4 \
pixman_0.17.4 \
pixman_0.9.6 \
pmacct_0.7.9 \
pmount_0.9.17 \
pmount_0.9.18 \
pmount_0.9.4 \
pocketsphinx_0.2.1 \
policykit-gnome_0.9.2 \
policykit_0.9 \
poppler-data_0.1 \
poppler_0.11.3 \
poppler_0.12.1 \
poppler_0.5.9 \
poppler_0.6.4 \
poppler_0.8.4 \
popt_1.7 \
portmap_5-25 \
portmap_5-26 \
portmap_5-9 \
postfix_2.0.20 \
postfix_2.2.12 \
postgresql_8.1.4 \
postgresql_8.1.8 \
postgresql_8.2.17 \
povray_3.6.1 \
powertop_1.10 \
powertop_1.8 \
ppp_2.4.1 \
ppp_2.4.3 \
pptp-linux_1.5.0 \
prboom_2.2.6 \
prboom_2.3.1 \
prboom_2.4.7 \
prelink_20061027 \
prelink_20071009 \
prism54-firmware_1.0.3.0 \
prismstumbler_0.7.2 \
psmisc_20.2 \
psmisc_21.8 \
pth_2.0.0 \
ptlib_2.4.4 \
ptlib_2.5.2 \
ptlib_2.6.1 \
ptlib_2.6.2 \
ptlib_2.6.4 \
ptlib_2.6.5 \
ptlib_2.8.0 \
pulseaudio_0.9.15 \
puppy_1.8 \
puppy_1.9 \
pvrusb2-mci_20060903 \
pwc_10.0.6a \
pwc_10.0.7a \
pwc_10.0.9-rc1 \
pwlib_1.5.2 \
pxaregs_1.14 \
python-coherence_0.6.2 \
python-django_1.0.2 \
python-gst_0.10.10 \
python-native_2.6.1 \
python-native_2.6.4 \
python-numpy_1.1.1 \
python-pybluez_0.15 \
python-pycairo_1.4.0 \
python-pycurl_7.18.2 \
python-pygtk_2.10.4 \
python-pygtk_2.6.3 \
python-scons-native_1.2.0 \
python-scons_1.2.0 \
python-sip_4.7.9 \
python-twisted_2.5.0 \
qc-usb-messenger_0.8 \
qof_0.6.0 \
qpegps_0.9.2.3.3 \
qpf-qte_2.3.10 \
qscintilla_1.60-gpl-1.3 \
qscintilla_1.60-gpl-1.3b \
qt-x11-free_3.3.6 \
qt4-embedded-gles_4.6.0 \
qt4-embedded-gles_4.6.2 \
qt4-embedded_4.6.0 \
qt4-embedded_4.6.2 \
qt4-tools-native_4.6.0 \
qt4-tools-native_4.6.2 \
qt4-tools-sdk_4.5.2 \
qt4-tools-sdk_4.6.0 \
qt4-tools-sdk_4.6.2 \
qt4-x11-free-gles_4.5.2 \
qt4-x11-free-gles_4.6.0 \
qt4-x11-free-gles_4.6.2 \
qt4-x11-free_4.6.0 \
qt4-x11-free_4.6.2 \
qwo_0.4 \
radvd_0.7.2 \
randrproto_1.2.1 \
rdesktop_1.3.1 \
rdesktop_1.4.1 \
rdesktop_1.5.0 \
rdiff-backup_1.0.4 \
readline_4.3 \
readline_5.2 \
realpath_1.10 \
renderproto_0.11 \
resolvconf_1.43 \
rp-pppoe_3.5 \
rsync_2.6.9 \
rsync_3.0.0 \
rsyslog_5.4.0 \
rsyslog_5.5.4 \
rt2570-k2wrlz_1.6.0 \
rt2570-k2wrlz_1.6.1 \
rt73-k2wrlz_1.0.0 \
rt73-k2wrlz_2.0.1 \
ruby_1.8.5 \
rxvt-unicode_4.8 \
rxvt-unicode_4.9 \
rxvt-unicode_5.2 \
rxvt-unicode_5.3 \
rxvt-unicode_5.4 \
rxvt-unicode_5.6 \
rxvt-unicode_7.7 \
rxvt_2.7.9 \
rygel_0.4.8 \
sablevm-classpath_1.1.9 \
sablevm-classpath_1.11.3 \
sablevm_1.1.9 \
sablevm_1.11.3 \
samba-ads_3.2.15 \
samba_3.0.23c \
samba_3.2.15 \
samba_3.3.0 \
sane-backends_1.0.19 \
schroedinger_0.2.0.0 \
screen_4.0.2 \
scummvm_0.12.0 \
scummvm_0.6.0 \
scummvm_0.6.1b \
scummvm_0.9.0 \
scummvm_0.9.1 \
scummvm_1.0.0 \
sed_4.0.8 \
sed_4.0.9 \
sed_4.1 \
sed_4.1.1 \
sed_4.1.2 \
sensors-applet_2.2.1 \
sessreg_1.0.5 \
shadow_4.1.4 \
shadow_4.1.4.1 \
shared-mime-info_0.20 \
shared-mime-info_0.22 \
slugos-init_0.10 \
slugos-init_4.8 \
smartmontools_5.33 \
smartmontools_5.37 \
smartmontools_5.38 \
sms_1.0 \
sofia-sip_1.11.7 \
sofia-sip_1.12.7 \
sox_12.17.5 \
sphinxbase_0.1 \
sqlite3_3.6.13 \
sqlite3_3.6.20 \
squashfs-tools_3.3 \
squid_2.7.STABLE8 \
sshfs-fuse_1.8 \
startup-notification_0.5 \
startup-notification_0.8 \
strace_4.5.11 \
strace_4.5.12 \
strace_4.5.14 \
strace_4.5.15 \
strace_4.5.18 \
streamripper_1.61.3 \
subversion_1.4.3 \
sudo_1.6.8p12 \
sugar-artwork_0.82.0 \
sugar-base_0.82.2 \
sugar-base_0.83.2 \
sugar-datastore_0.82.0 \
sugar-presence-service_0.82.2 \
sugar-toolkit_0.82.11 \
sugar-toolkit_0.83.3 \
sugar_0.82.9 \
sugar_0.83.4 \
supertux_0.1.2 \
swfdec-mozilla_0.7.2 \
swfdec-mozilla_0.7.4 \
swfdec-mozilla_0.8.2 \
swfdec_0.4.0 \
swfdec_0.7.2 \
swfdec_0.7.4 \
swfdec_0.8.2 \
swig_1.3.31 \
swig_1.3.38 \
swig_1.3.39 \
sylpheed_2.2.9 \
synergy_1.2.7 \
sysfsutils_2.0.0 \
sysklogd_1.4.1 \
syslog-ng_1.6.11 \
syslog-ng_1.6.8 \
sysstat_8.1.5 \
sysstat_8.1.6 \
taglib_1.4 \
tango-icon-theme_0.7.2 \
tangogps_0.9.6 \
tar_1.18 \
tar_1.20 \
tcl_8.4.19 \
tcpdump_3.9.7 \
tcpdump_4.0.0 \
telepathy-gabble_0.5.10 \
telepathy-gabble_0.7.8 \
telepathy-glib_0.5.10 \
telepathy-glib_0.6.0 \
telepathy-glib_0.7.14 \
telepathy-glib_0.7.29 \
telepathy-mission-control_4.21 \
telepathy-mission-control_4.22 \
telepathy-mission-control_4.45 \
telepathy-python_0.14.0 \
texinfo_4.8a \
tgt_0.9.10 \
thunar_0.9.0 \
thunar_1.0.1 \
tk_8.4.19 \
totem-pl-parser_2.28.1 \
totem_2.28.1 \
totem_2.28.5 \
transconnect_1.2 \
tre_0.7.5 \
tsclient_0.132 \
u-boot-omap2430sdp_1.1.4 \
u-boot-omap3beagleboard_1.1.4 \
u-boot_1.1.2 \
u-boot_1.1.4 \
u-boot_1.1.6 \
u-boot_1.2.0 \
u-boot_1.3.0 \
u-boot_1.3.1 \
u-boot_1.3.2 \
u-boot_2009.01 \
u-boot_2009.03 \
u-boot_2009.06 \
u-boot_2009.08 \
u-boot_2010.06 \
uclibc-initial_0.9.28 \
uclibc-initial_0.9.29 \
uclibc-initial_0.9.30 \
uclibc_0.9.28 \
uclibc_0.9.29 \
uclibc_0.9.30 \
ucview_0.22 \
udev_092 \
udev_097 \
udev_100 \
udev_118 \
udev_124 \
unicap_0.9.3 \
unicap_0.9.4 \
unionfs-utils_1.0.11 \
unixbench_4.1.0 \
upslug2-native_8 \
upslug2_10 \
upslug2_8 \
upstart_0.3.8 \
uqm_0.3 \
usbmodeswitch_1.0.7 \
usbutils_0.70 \
usbutils_0.73 \
usbutils_0.82 \
util-linux-ng_2.13.1 \
util-linux-ng_2.14 \
util-linux-ng_2.15 \
util-linux-ng_2.16 \
util-linux_2.12 \
util-linux_2.12o \
util-linux_2.12q \
util-macros_1.3.0 \
vagalume_0.5.1 \
vagalume_0.7.1 \
vala_0.8.1.2 \
vala_0.9.3.2 \
valgrind_3.2.1 \
valgrind_3.2.3 \
videoproto_2.3.0 \
viewres_1.0.1 \
visiscript_0.3.2 \
vlan_1.8 \
vlc-gpe_0.7.2 \
vlc-gpe_0.8.1 \
vlc_0.9.2 \
vlc_0.9.6 \
vlc_0.9.8a \
vlc_1.0.2 \
vorbis-tools_1.0.1 \
vpnc_0.3.2 \
vpnc_0.5.1 \
vte_0.16.14 \
vte_0.21.5 \
watchdog_5.2.6 \
watchdog_5.3.1 \
watchdog_5.4 \
wbxml2_0.9.2 \
wesnoth_1.4.6 \
wesnoth_1.6.5 \
wget_1.11.4 \
wget_1.9.1 \
whois_4.5.25 \
whois_5.0.0 \
wireshark_0.99.4 \
wlan-ng-utils_0.2.7 \
wpa-gui_0.4.8 \
wpa-gui_0.6.4 \
wpa-supplicant_0.4.7 \
wpa-supplicant_0.4.8 \
wpa-supplicant_0.4.9 \
wpa-supplicant_0.6.0 \
wpa-supplicant_0.6.3 \
wpa-supplicant_0.6.7 \
wscan_20080720 \
wt3_2.99.0 \
wt3_3.0.0 \
wt_2.2.0 \
wvdial_1.56 \
wxwidgets_2.8.10 \
x11vnc_0.9.4 \
x11vnc_0.9.7 \
x11vnc_0.9.8 \
x11vnc_0.9.9 \
xapian-core_1.0.13 \
xapian-core_1.0.5 \
xapian-core_1.0.7 \
xbiff_1.0.1 \
xcalc_1.0.2 \
xcb-proto_0.9.91 \
xcb-proto_0.9.92 \
xcb-proto_0.9.93 \
xcb-proto_1.0 \
xcb-util_0.1 \
xcb-util_0.2 \
xchat_2.8.4 \
xcompmgr_1.1.4 \
xditview_1.0.1 \
xdm_1.1.9 \
xextproto_7.0.5 \
xextproto_7.1.1 \
xf86-input-aiptek_1.3.0 \
xf86-input-elographics_1.2.3 \
xf86-input-evdev_2.3.0 \
xf86-input-penmount_1.4.0 \
xf86-input-synaptics_1.2.0 \
xf86-input-tslib_0.0.5 \
xf86-input-vmmouse_12.6.5 \
xf86-video-apm_1.2.2 \
xf86-video-ark_0.7.2 \
xf86-video-ast_0.89.9 \
xf86-video-ati_6.12.4 \
xf86-video-chips_1.2.2 \
xf86-video-dummy_0.3.2 \
xf86-video-fbdev_0.4.1 \
xf86-video-geode_2.11.6 \
xf86-video-i128_1.3.3 \
xf86-video-neomagic_1.2.4 \
xf86-video-nv_2.1.15 \
xf86-video-openchrome_0.2.902 \
xf86-video-rendition_4.2.3 \
xf86-video-siliconmotion_1.7.3 \
xf86-video-sis_0.10.2 \
xf86-video-sisusb_0.9.3 \
xf86-video-trident_1.3.3 \
xf86-video-tseng_1.2.3 \
xf86-video-vmware_10.16.8 \
xf86-video-voodoo_1.2.3 \
xf86-video-xgi_1.5.1 \
xf86-video-xgixp_1.7.99.4 \
xfcalendar_4.2.0 \
xfcalendar_4.2.2 \
xfce-terminal_0.2.12 \
xfce-terminal_0.2.8 \
xfce-terminal_0.4.2 \
xfce-utils_4.4.2 \
xfce-utils_4.6.1 \
xfce4-appfinder_4.4.2 \
xfce4-appfinder_4.6.1 \
xfce4-dev-tools_4.4.0.1 \
xfce4-mixer_4.4.2 \
xfce4-panel_4.4.2 \
xfce4-panel_4.6.1 \
xfce4-panel_4.6.2 \
xfce4-panel_4.6.3 \
xfce4-session_4.4.2 \
xfce4-session_4.6.1 \
xfce4-settings_4.6.1 \
xfce4-settings_4.6.4 \
xfconf_4.6.1 \
xfdesktop_4.4.2 \
xfdesktop_4.6.1 \
xffm_4.2.0 \
xffm_4.2.2 \
xffm_4.3.99.2 \
xfprint_4.3.99.2 \
xfprint_4.4.2 \
xfsprogs_2.8.16 \
xfwm4-themes_4.4.2 \
xfwm4_4.4.2 \
xfwm4_4.6.1 \
xgc_1.0.1 \
xinit_1.1.1 \
xinput-calibrator_0.5.0 \
xinput-calibrator_0.6.0 \
xinput_1.5.0 \
xkbprint_1.0.1 \
xkeyboard-config_1.4 \
xlogo_1.0.1 \
xlsatoms_1.0.2 \
xlsclients_1.0.2 \
xlsfonts_1.0.2 \
xmessage_1.0.2 \
xmonobut_0.4 \
xmore_1.0.1 \
xorg-sgml-doctools_1.3 \
xournal_0.3.3 \
xournal_0.4 \
xournal_0.4.0.1 \
xournal_0.4.1 \
xproto_7.0.16 \
xrandr_1.2.0 \
xrandr_1.3.2 \
xserver-common_1.11 \
xserver-common_1.12 \
xserver-common_1.13 \
xserver-common_1.14 \
xserver-common_1.15 \
xserver-common_1.16 \
xserver-common_1.18 \
xserver-common_1.21 \
xserver-common_1.22 \
xserver-common_1.24 \
xserver-common_1.25 \
xserver-common_1.30 \
xserver-common_1.31 \
xserver-common_1.32 \
xserver-common_1.33 \
xserver-kdrive_1.1.0 \
xserver-kdrive_1.2.0 \
xserver-kdrive_1.3.0.0 \
xserver-kdrive_1.4 \
xserver-kdrive_1.4.0.90 \
xserver-kdrive_1.4.99.901 \
xserver-nodm-init_1.0 \
xserver-xorg_1.7.1 \
xserver-xorg_1.7.4 \
xserver-xorg_1.8.1 \
xset_1.1.0 \
xtables-addons_1.26 \
xterm_207 \
xtscal_0.4 \
xtscal_0.5 \
xtscal_0.5.1 \
xvidtune_1.0.1 \
ypbind-mt_1.18 \
zile_1.7+2.0beta6 \
zlib_1.2.3 \
"

############################################

PKGDUP_IGNORES = " \
bash_3.0 \
bluez-libs_3.36 \
boost_1.33.1 \
cherokee_0.99.24 \
chillispot_1.0RC3 \
compcache_0.5+0.6pre3 \
cppunit_1.10.2 \
ctorrent_1.3.4 \
dbus_1.3.1 \
dhcdbd_1.16 \
dhcdbd_2.0 \
dtc-native_20070216 \
dtc_20070216 \
eglibc-initial_2.10 \
eglibc_2.10 \
emacs-x11_20060801 \
emacs-x11_22.3 \
emacs_20060801 \
emacs_22.3 \
exo_0.3.105 \
gail_1.8.5 \
gcalctool_5.7.32 \
gcc-cross-initial_3.3.4 \
gcc-cross-initial_4.0.2 \
gcc-cross-initial_4.1.2 \
gcc-cross-initial_4.2.4 \
gcc-cross-initial_4.3.4 \
gcc-cross-initial_4.4.4 \
gcc-cross-intermediate_3.3.4 \
gcc-cross-intermediate_4.0.2 \
gcc-cross-intermediate_4.1.2 \
gcc-cross-intermediate_4.2.4 \
gcc-cross-intermediate_4.3.4 \
gcc-cross-intermediate_4.4.4 \
gcc-cross-sdk_3.3.4 \
gcc-cross-sdk_4.1.2 \
gcc-cross-sdk_4.2.4 \
gcc-cross-sdk_4.3.4 \
gcc-cross-sdk_4.4.4 \
gcc-cross_3.3.4 \
gcc-cross_4.0.2 \
gcc-cross_4.1.2 \
gcc-cross_4.2.4 \
gcc-cross_4.3.4 \
gcc-cross_4.4.4 \
gcc_3.3.4 \
gcc_4.0.2 \
gcc_4.1.2 \
gcc_4.2.4 \
gcc_4.3.4 \
gcc_4.4.4 \
gconf_2.6.1 \
gxine_0.4.1enhanced \
htmldoc-gui_1.9.x-r1571 \
htmldoc-native_1.9.x-r1571 \
htmldoc_1.9.x-r1571 \
iqnotes_2.0.99-2.1.0rc1 \
lcd4linux_0.11.0-SVN \
libdisplaymigration_0.99 \
libeventdb_0.90 \
libffi_2.0+gcc4.3.2 \
libsvg-cairo_20050601 \
libx11_1.1.5 \
libxfce4util_4.4.2 \
libxfcegui4_4.4.2 \
lmbench_3.0-a9 \
lxpanel_0.3.99 \
madwifi-modules_cvs-bsd \
mathomatic_unstable \
mipv6_1.1-v2.4.26 \
mono-xsp_1.2.5 \
mtd-utils_1.1.0 \
network-manager-applet_0.7.1.997 \
ntfs-3g_2009.4.4 \
nzbget_0.7.0-testing \
osb-browser_20060212 \
osb-jscore_20070816 \
osb-nrcit_20070816 \
osb-nrcore_20070816 \
prismstumbler_0.7.3+0.7.4pre1 \
qt4-embedded_4.5.2 \
qt4-embedded_4.7.0-beta2 \
qt4-tools-native_4.5.2 \
qt4-tools-native_4.7.0-beta2 \
qt4-x11-free_4.5.2 \
qt4-x11-free_4.7.0-beta2 \
samba_3.0.34 \
shorewall_2.0.9-monolithic \
spandsp_0.0.4-pre16 \
sysfsutils_1.3.0 \
tango-icon-theme_0.8.90 \
tracker_0.6.95 \
upstart-setup_devel \
ushare_0.9.7 \
vino_2.16.0 \
vpnc_0.3.3 \
wpa-supplicant_0.5.10 \
wvstreams_4.2.2 \
wvstreams_4.4.1 \
xcb-proto_0.9 \
xchat_2.6.8 \
xf86-video-mga_1.9.100 \
xf86-video-intel_2.9.1 \
xf86-video-vesa_2.2.1 \
xscreensaver_4.22 \
xserver-kdrive_1.4.2 \
ztappy_0.9.3ern \
"
```
