## conf/distro/include/elito-patches.inc
```bitbake
# --*- python -*--
SRC_URI_append_pn-ipkg-utils-native = " \
        file://${ELITO_TOPDIR}/files/ipkg-utils/license.patch;apply=yes"
SRC_URI_append_pn-ipkg-utils        = "\
        file://${ELITO_TOPDIR}/files/ipkg-utils/license.patch;apply=yes"

SRC_URI_append_pn-opkg-native = " \
        file://${ELITO_TOPDIR}/files/opkg/license-info.patch;apply=yes"
SRC_URI_append_pn-opkg        = " \
        file://${ELITO_TOPDIR}/files/opkg/license-info.patch;apply=yes"

SRC_URI_append_pn-busybox     = " \
	file://elito-directory.patch;apply=yes \
        file://cvt-color.patch;apply=yes \
        file://busybox-mbus-env.patch;apply=yes \
        file://ifup-upstart.patch;apply=yes"

# Due to the elito-directory.patch above
ALTERNATIVE_LINK_pn-iproute2 = "${base_sbindir}/ip"

SRC_URI_append_pn-base-passwd = " \
        file://elito-passwd.patch;apply=yes \
        ${PROJECT_PASSWD_PATCH}"

SRC_URI_append_pn-ifupdown = " \
	file://upstart.patch;apply=yes"

SRC_URI_append_pn-bootchart-lite = " \
	file://elito.patch;apply=yes"
```

## conf/distro/include/elito-revs.inc
```bitbake
# --*- python -*--
_elito-gcc-version                        = "4.5"
_elito-gcc-version_arm                    = \
    "${@elito_base_switch(d, 'TARGET_CPU',   \
                          'iwmmxt', '4.3.4', \
                          '4.5')}"

PREFERRED_VERSION_gcc                    ?= "${_elito-gcc-version}"

PREFERRED_VERSION_gcc-cross              ?= "${PREFERRED_VERSION_gcc}"
PREFERRED_VERSION_gcc-cross-sdk          ?= "${PREFERRED_VERSION_gcc}"
PREFERRED_VERSION_gcc-cross-initial      ?= "${PREFERRED_VERSION_gcc}"
PREFERRED_VERSION_gcc-cross-intermediate ?= "${PREFERRED_VERSION_gcc}"

PREFERRED_VERSION_linux-libc-headers     ?= "${MACHINE_KERNEL_VERSION}"

PREFERRED_VERSION_glibc                  ?= "2.10.1"
PREFERRED_VERSION_glibc-initial          ?= "${PREFERRED_VERSION_glibc}"

PREFERRED_VERSION_eglibc                 ?= "2.12"
PREFERRED_VERSION_eglibc-initial         ?= "${PREFERRED_VERSION_eglibc}"

PREFERRED_VERSION_uclibc                 ?= "0.9.31"
PREFERRED_VERSION_uclibc-initial         ?= "${PREFERRED_VERSION_uclibc}"

LIBTOOL_HAS_SYSROOT                      ?= "yes"
PREFERRED_VERSION_libtool                ?= "2.4"
PREFERRED_VERSION_libtool-native         ?= "${PREFERRED_VERSION_libtool}"
PREFERRED_VERSION_libtool-cross          ?= "${PREFERRED_VERSION_libtool}"
PREFERRED_VERSION_libtool-nativesdk      ?= "${PREFERRED_VERSION_libtool}"
PREFERRED_VERSION_libtool-sdk            ?= "${PREFERRED_VERSION_libtool}"

SRCREV_pn-dietlibc         ?= "749ea37e7793f58be8f0131b82d1affd249de244"
```

## conf/machine/atom-ion-32.conf
```bitbake
#@TYPE: Machine
#@Name: Atom
#@DESCRIPTION: Machine configuration for Atom ION platform (32 bit)

TARGET_ARCH		 = "i686"
TARGET_CPU		 = "atom"

MACHINE_DRI_MODULES	?= "nouveau"
MACHINE_FEATURES	 = "kernel26 screen keyboard pci usbhost ext3 x86 acpi ${PROJECT_FEATURES}"
MACHINE_KERNEL_VERSION	?= "2.6.38"
KERNEL_BRANCH		?= "atom/ion32"
KERNEL_DEFCONFIG	?= "atom_ion32_defconfig"
KERNEL_IMAGETYPE	 = "bzImage"

require conf/machine/include/tune-atom.inc

TARGET_CC_ARCH		 = "-m32 -march=atom"
GLIBC_ADDONS		 = "nptl,libidn"
GLIBC_EXTRA_OECONF	 = "--with-tls"

KERNEL_CONSOLE		?= ""
```

## conf/machine/kk-trizeps4.conf
```bitbake
#@TYPE: Machine
#@Name: Keith & Koep Trizeps IV (PXA270)
#@DESCRIPTION: Machine configuration for Keith & Koep Trizeps IV (PXA270)

TARGET_ARCH		 = "arm"
TARGET_CPU		 = 'iwmmxt'
TARGET_ABI		 = "aapcs-linux"
TARGET_FPU		 = "soft"
TARGET_OS		 = "linux-gnueabi"

MACHINE_FEATURES	?= "iwmmxt kernel26 jffs2 arnoldboot kdebug ${PROJECT_FEATURES}"
MACHINE_KERNEL_VERSION	?= "2.6.31"
KERNEL_BRANCH		?= "kk/trizeps4"
KERNEL_DEFCONFIG	?= "trizeps4_defconfig"
KERNEL_IMAGETYPE	 = "zImage"

MACHINE_DISPLAY_BPP		?= "16"
MACHINE_DISPLAY_WIDTH_PIXELS	?= "800"
MACHINE_DISPLAY_HEIGHT_PIXELS	?= "480"

RDEPENDS_kernel-base	 = ""

require conf/machine/include/tune-iwmmxt.inc

SERIAL_CONSOLE		 = "115200 ttySA0"
EXTRA_OECONF_BASE=

FLASH_ERASESIZE		?= "${@0x00040000}"

KERNEL_OFFSET		?= "${@0x00080000}"
KERNEL_SIZE		?= "${@0x001c0000}"

ROOTFS_OFFSET		?= "${@${KERNEL_OFFSET} + ${KERNEL_SIZE}}"
ROOTFS_SIZE		?= "${@32*1024*1024 - ${ROOTFS_OFFSET}}"

EXTRA_IMAGECMD_jffs2	 =+ "--pad=${ROOTFS_SIZE} --little-endian --eraseblock=${FLASH_ERASESIZE}"
```

## conf/machine/omap-beagle.conf
```bitbake
#@TYPE: Machine
#@Name: Phytec PCM034
#@DESCRIPTION: Machine configuration for OMAP Beagle Platform

TARGET_ARCH		 = "arm"
TARGET_CPU		 = 'cortex-a8'
TARGET_ABI		 = "aapcs-linux"
TARGET_FPU		 = "soft"
TARGET_OS		 = "linux-gnueabi"

MACHINE_FEATURES	?= "kernel26 kdebug ${PROJECT_FEATURES}"
MACHINE_KERNEL_VERSION	?= 2.6.33
KERNEL_BRANCH		?= omap/beagle
KERNEL_DEFCONFIG	?= omap_beagle_defconfig
KERNEL_IMAGETYPE	 = uImage

UBOOT_MACHINE		?= "omap_beagle_config"
UBOOT_BRANCH		?= "omap/beagle"

require conf/machine/include/tune-cortexa8.inc

SERIAL_CONSOLE		 = "115200 ttySA0"
EXTRA_OECONF_BASE=
```

## conf/machine/phytec-pca102.conf
```bitbake
#@TYPE: Machine
#@Name: Phytec PhyCard-L (PCA102)
#@DESCRIPTION: Machine configuration for Phytec PhyCard-L (PCA102)

TARGET_ARCH		 = "arm"
TARGET_CPU		 = 'cortex-a8'
TARGET_ABI		 = "aapcs-linux"
TARGET_FPU		 = "soft"

SOC_FAMILY		 = "omap3"

MACHINE_FEATURES	?= "kernel26 barebox kdebug ${PROJECT_FEATURES}"
MACHINE_KERNEL_VERSION	?= "2.6.38"
KERNEL_BRANCH		?= "phytec/pca102"
KERNEL_DEFCONFIG	?= "pca102_defconfig"
KERNEL_IMAGETYPE	 = "uImage"

UBOOT_VERSION		?= "2010.10.0"
UBOOT_MACHINE		?= "pca102_defconfig"
UBOOT_BRANCH		?= "phytec/pca102"

require conf/machine/include/tune-cortexa8.inc

SERIAL_CONSOLE		?= "115200 ttyO2"
EXTRA_OECONF_BASE=
```

## conf/machine/phytec-pcm027.conf
```bitbake
#@TYPE: Machine
#@Name: Phytec PCM027 (PXA270)
#@DESCRIPTION: Machine configuration for Phytec PCM027 (PXA270) Evaluation Board

TARGET_ARCH		 = "arm"
#TARGET_CPU		 = 'iwmmxt'
TARGET_ABI		 = "aapcs-linux"
TARGET_FPU		 = "soft"
TARGET_OS		 = "linux-gnueabi"

MACHINE_FEATURES	?= "iwmmxt kernel26 jffs2 u-boot kdebug ${PROJECT_FEATURES}"
MACHINE_KERNEL_VERSION	?= "2.6.34"
KERNEL_BRANCH		?= "phytec/pcm027"
KERNEL_DEFCONFIG	?= "pcm027_defconfig"
KERNEL_IMAGETYPE	 = "uImage"

UBOOT_VERSION           ?= "2010.03"
UBOOT_MACHINE           ?= "pcm027_config"
UBOOT_BRANCH            ?= "phytec/pcm027"

MACHINE_DISPLAY_BPP		?= "16"
MACHINE_DISPLAY_WIDTH_PIXELS	?= "800"
MACHINE_DISPLAY_HEIGHT_PIXELS	?= "480"

RDEPENDS_kernel-base	 = ""

require conf/machine/include/tune-xscale.inc

SERIAL_CONSOLE		?= "115200 ttySA0"
EXTRA_OECONF_BASE=

FLASH_ERASESIZE		?= "${@0x00040000}"

KERNEL_OFFSET		?= "${@0x00040000}"
KERNEL_SIZE		?= "${@0x001c0000}"

ROOTFS_OFFSET		?= "${@${KERNEL_OFFSET} + ${KERNEL_SIZE}}"
ROOTFS_SIZE		?= "${@32*1024*1024 - ${ROOTFS_OFFSET}}"

EXTRA_IMAGECMD_jffs2	 =+ "--pad=${ROOTFS_SIZE} --little-endian --eraseblock=${FLASH_ERASESIZE}"

KERNEL_CMDLINE		?=  "root=/dev/mtdblock2 rw rootfstype=jffs2 console=${KERNEL_CONSOLE}"
```

## conf/machine/phytec-pcm034.conf
```bitbake
#@TYPE: Machine
#@Name: Phytec PCM034
#@DESCRIPTION: Machine configuration for Phytec PCM034 Platform 

TARGET_ARCH		 = "arm"
TARGET_CPU		 = 'iwmmxt'
TARGET_ABI		 = "aapcs-linux"
TARGET_OS		 = "linux-gnueabi"

MACHINE_FEATURES	?= "kernel26 kdebug ubifs mobm320 u-boot ${PROJECT_FEATURES}"
MACHINE_KERNEL_VERSION	?= 2.6.27
KERNEL_BRANCH		?= phytec/pcm034
KERNEL_DEFCONFIG	?= pcm034_defconfig
KERNEL_IMAGETYPE	 = uImage

UBOOT_MACHINE		?= "pcm034_config"
UBOOT_BRANCH		?= "phytec/pcm034"

NAND_PAGESIZE		 =      2048
NAND_BLOCKSIZE		 =    131072
FLASH_SIZE		 = 134217728

RDEPENDS_kernel-base	 = ""

MOBM320_IMAGE		?= mobm-pcm034-0.1.img
MOBM320_ENV_ARGS	?= '--serial 0x001122334455'

ROOTFS_SIZE		?= 52428800
UBI_VOLUMES		?= "\
	kernel		static	${KERNEL_IMAGETYPE}-${MACHINE}.bin	2097152,	\
	bootenv		static	${IMAGE_NAME}.rootfs.bootenv		  16384,	\
	bootloader	static	u-boot-${MACHINE}.bin			 131072,	\
	rootfs		dynamic	${IMAGE_NAME}.rootfs.ubifs	  ${ROOTFS_SIZE}	\
"

require conf/machine/include/tune-iwmmxt.inc

SERIAL_CONSOLE		 = "115200 ttySA0"
EXTRA_OECONF_BASE=
```

## conf/machine/toradex-colibri270.conf
```bitbake
#@TYPE: Machine
#@Name: Toradex Colibri320 PXA270
#@DESCRIPTION: Machine configuration for Toradex Colibri270 PXA320 Platform 

TARGET_ARCH		 = "arm"
TARGET_CPU		 = 'iwmmxt'
TARGET_ABI		 = "aapcs-linux"
TARGET_FPU		 = "soft"
TARGET_OS		 = "linux-gnueabi"

MACHINE_FEATURES	?= "iwmmxt kernel26 kdebug u-boot ${PROJECT_FEATURES}"
MACHINE_KERNEL_VERSION	?= 2.6.27
KERNEL_BRANCH		?= toradex/colibri270
KERNEL_DEFCONFIG	?= colibri270_defconfig
KERNEL_IMAGETYPE	 = uImage

UBOOT_MACHINE		?= "colibri270_config"
UBOOT_BRANCH		?= "toradex/colibri270"

MACHINE_DISPLAY_BPP		?= 24
MACHINE_DISPLAY_WIDTH_PIXELS	?= 640
MACHINE_DISPLAY_HEIGHT_PIXELS	?= 480

RDEPENDS_kernel-base	 = ""

require conf/machine/include/tune-iwmmxt.inc

SERIAL_CONSOLE		 = "115200 ttySA1"
EXTRA_OECONF_BASE=

ROOT_FLASH_SIZE		 = "32"
EXTRA_IMAGECMD_jffs2	 =+ "--pad --little-endian --eraseblock=131072"
```

## conf/machine/toradex-colibri320.conf
```bitbake
#@TYPE: Machine
#@Name: Toradex Colibri320 PXA320
#@DESCRIPTION: Machine configuration for Toradex Colibri320 PXA320 Platform

TARGET_ARCH		 = "arm"
TARGET_CPU		 = 'iwmmxt'
TARGET_ABI		 = "aapcs-linux"
TARGET_FPU		 = "soft"
TARGET_OS		 = "linux-gnueabi"

MACHINE_FEATURES	?= "iwmmxt kernel26 kdebug ubifs mobm320 u-boot ${PROJECT_FEATURES}"
MACHINE_KERNEL_VERSION	?= 2.6.30
KERNEL_BRANCH		?= toradex/colibri320
KERNEL_DEFCONFIG	?= colibri320_defconfig
KERNEL_IMAGETYPE	 = uImage

UBOOT_MACHINE		?= "colibri320_config"
UBOOT_BRANCH		?= "toradex/colibri320"

NAND_PAGESIZE		 =       2048
NAND_BLOCKSIZE		 =     131072
FLASH_SIZE		 = 1073741824

MACHINE_DISPLAY_BPP		?= 24
MACHINE_DISPLAY_WIDTH_PIXELS	?= 640
MACHINE_DISPLAY_HEIGHT_PIXELS	?= 480

RDEPENDS_kernel-base	 = ""

MOBM320_IMAGE		?= mobm-colibri320-1.2.img
MOBM320_ENV_ARGS	?= '--serial 0x001122334455'

ROOTFS_SIZE		?= 52428800
UBI_VOLUMES		?= "\
	kernel		static	${KERNEL_IMAGETYPE}-${MACHINE}.bin	2097152,	\
	bootenv		static	${IMAGE_NAME}.bootenv		16384,		\
	bootloader	static	u-boot-${MACHINE}.bin		131072,		\
	rootfs		dynamic	${IMAGE_NAME}.rootfs.ubifs	${ROOTFS_SIZE}	\
"

require conf/machine/include/tune-iwmmxt.inc

SERIAL_CONSOLE		 = "115200 ttySA1"
EXTRA_OECONF_BASE=
```

## conf/machine/x86-nehalem-64.conf
```bitbake
TARGET_ARCH = "x86_64"
MACHINE_ARCH = "x86-nehalem-64"

TARGET_CC_ARCH           = "-march=core2 -mtune=generic -m64 -msse4.2"
TARGET_CC_KERNEL_ARCH    = "-march=core2 -mtune=generic -m64 -msse4.2"

MACHINE_FEATURES	 = "kernel26 screen keyboard pci usbhost ext3 x86_64 acpi ${PROJECT_FEATURES}"
MACHINE_KERNEL_VERSION	?= "2.6.38"
KERNEL_BRANCH		?= "nehalem64"
KERNEL_DEFCONFIG	?= "nehalem64_defconfig"
KERNEL_IMAGETYPE	 = "bzImage"

GLIBC_ADDONS		 = "nptl,libidn"
GLIBC_EXTRA_OECONF	 = "--with-tls"

KERNEL_CONSOLE		?= ""
```

## meta-backports/conf/layer.conf
```bitbake
BBPATH ?= ""
# We have a conf and classes directory, add to BBPATH
BBPATH .= ":${LAYERDIR}"

BBFILES += "${LAYERDIR}/recipes/*/*.bb"

BBFILE_COLLECTIONS     += "elitobp"
BBFILE_PATTERN_elitobp := "^${LAYERDIR}/"
BBFILE_PRIORITY_elitobp =  80
```

## meta-fixup/conf/layer.conf
```bitbake
# We have a conf and classes directory, add to BBPATH
BBPATH .= ":${LAYERDIR}"

BBFILES += "\
  ${LAYERDIR}/recipes/*/*.bbappend \
  ${@bb.utils.contains('BBFILE_COLLECTIONS','multimedia-layer',\
      '${LAYERDIR}/recipes-multimedia/*/*.bbappend','',d)} \
  ${@bb.utils.contains('BBFILE_COLLECTIONS','gnome-layer', \
      '${LAYERDIR}/recipes-gnome/*/*.bbappend','',d)} \
  ${@bb.utils.contains('BBFILE_COLLECTIONS','qt5-layer',\
      '${LAYERDIR}/recipes-qt5/*/*.bbappend','',d)} \
"

BBFILE_COLLECTIONS     += "fixup"
BBFILE_PATTERN_fixup := "^${LAYERDIR}/"
BBFILE_PRIORITY_fixup =  "90"
```
