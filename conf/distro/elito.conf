## conf/distro/elito.conf
```bitbake
#-----------------------------------------------------------------------------
#@TYPE: Distribution
#@NAME: Minimal
#@DESCRIPTION: Embedded Linux Distribution Configuration (minimal)
#
#@COMMENT: This distribution configuration serves as a starting point for
#@COMMENT: the integration of new target platforms, machines, or distributions.
#@COMMENT: It bases on conservative settings and should always be buildable.
#-----------------------------------------------------------------------------

#
# Header
#
DISTRO_NAME          = "ELiTo"
DISTRO_VERSION_MAJOR = "0.93"
MAINTAINER	     = "SIGMA Chemnitz GmbH <elito@sigma-chemnitz.de>"

DISTRO_VERSION       = "${DISTRO_VERSION_MAJOR}.${SRCDATE}"
DISTRO_TYPE	    := "${@['debug','release'][os.environ.get('W','tmp').startswith('release-')]}"

IMAGE_DEV_MANAGER   ?= "udev"
IMAGE_INIT_MANAGER  ?= "upstart"
IMAGE_INITSCRIPTS   ?= "${@elito_base_switch(d, 'IMAGE_INIT_MANAGER', \
'upstart','upstart-setup', '')}"

SRC_DIST_LOCAL	    ?= "symlink"
INHERIT += "devshell debian elito packaged-staging packagehistory insane \
	src_distribute_local \
	pkg_metainfo amend"

IMAGE_FSTYPES ?= "	\
	tar.bz2		\
	${@base_contains('MACHINE_FEATURES','ubifs','ubifs ubi','',d)}	\
	${@base_contains('MACHINE_FEATURES','jffs2','jffs2','',d)}	\
	${@base_contains('MACHINE_FEATURES','arnoldboot','arnoldboot','',d)}	\
"

BB_LOCALCOUNT_OVERRIDE =
DISABLE_QEMU	     = true

QA_LOG		     = 1
BBMASK_DISTRO        = "\
(?:(/([^/]*-)?(angstrom|initramfs|mingw|openmoko|opie|sugar|libsdl-qpe)[-_].*)|\
(/((linux(-atm)?)|mamona|maemo|maemo4|maemo-mapper|gpephone|meta|moblin|libqpe|odcctools|ti|shr|sharprom-toolchain)/[^/]*\.bb)|\
(?:/org.openembedded/recipes/(((upstart)/.*)|(udev/udev.*\.bb)|(linux-libc-headers/linux-libc-headers_.*\.bb)|(u-boot/u-boot-mkimage_.*\.bb)|(mtd/mtd-utils_.*\.bb)))|\
(?:/preboot/.*\.bb)|\
(?:/kexecboot/.*\.bb))"

BBMASK_DISTRO_BASENAMES = "${ELITO_OLD_CRUFT}"

BBMASK_BASENAMES ?= "${BBMASK_DISTRO_BASENAMES}"

ELITO_MIRROR	 ?= "http://www.sigma-chemnitz.de/dl/elito/sources"
ELITO_GIT_REPO	 ?= "git://git.sigma-chemnitz.de:4815"
ELITO_GIT_WS	 ?= "${ELITO_WORKSPACE_DIR}"

PROJECT_PASSWD_PATCH ?= ""

MIRRORS_append = "${@'\n'.join([		\
	"ftp://.*/.*	${ELITO_MIRROR}/",	\
	"http://.*/.*	${ELITO_MIRROR}/",	\
	"svn://.*/.*	${ELITO_MIRROR}/",	\
	"cvs://.*/.*	${ELITO_MIRROR}/",	\
	"git://.*/.*	${ELITO_MIRROR}/",	\
	"hg://.*/.*	${ELITO_MIRROR}/",	\
])}"

PROJECT_FILE_DATE = "${@get_filedate('${PROJECT_TOPDIR}/conf/project.conf')}"
FILESPATHBASE_prepend = "\
${PROJECT_TOPDIR}/files:\
${ELITO_TOPDIR}/files:\
"

PROJECT_CONF_DATE = "${@max(map(lambda x: \
	(get_filedate(x) or 0), \
	['${PROJECT_TOPDIR}/conf',] + \
	elito_glob('${PROJECT_TOPDIR}/conf/*.conf')))}"

DISTRO_CRYPTOPROVIDERS = "openssl:gnutls:*"

SRCPV = "${@bb.fetch.get_srcrev(d)}"

PACKAGE_EXTRA_ARCHS .= "${@['',' xscale']['xscale' in '${MACHINE_FEATURES}'.split()]}"
PACKAGE_EXTRA_ARCHS .= "${@['',' xscale iwmmxt']['iwmmxt' in '${MACHINE_FEATURES}'.split()]}"

#
# Kernel
#
KERNEL			 = "kernel26"
OLDEST_KERNEL		?= "2.6.27"
KERNEL_UIMAGE		 = 1
MACHINE_TASK_PROVIDER	?= "elito-task-core"

KERNEL_CONSOLE		?=  "${@(lambda x: '%s,%sn8' % (x[1],x[0]))('${SERIAL_CONSOLE}'.split())}"

DISTRO_LIBC		?= "eglibc"
DISTRO_FEATURES		?= "ipv4 ipv6"
PROJECT_FEATURES	?= "modules usb eabi"
FEED_BASE_URI           ?= "http://${TFTP_SERVER}:8888/${PROJECT_NAME}/ipk"

ELITO_CRYPTO_PROVIDER	?= "openssl"

#
# Binutils & Compiler
#
PREFERRED_PROVIDER_virtual/arm-${TARGET_OS}-binutils	    = "binutils-cross"

PREFERRED_PROVIDER_virtual/${TARGET_PREFIX}gcc-initial	    = "gcc-cross-initial"
PREFERRED_PROVIDER_virtual/${TARGET_PREFIX}gcc-intermediate = "gcc-cross-intermediate"
PREFERRED_PROVIDER_virtual/${TARGET_PREFIX}gcc		    = "gcc-cross"
PREFERRED_PROVIDER_virtual/${TARGET_PREFIX}g++		    = "gcc-cross"

PREFERRED_PROVIDER_virtual/libsdl        ?= "libsdl-x11"
PREFERRED_PROVIDER_virtual/libqte2       ?= "qte-mt"
PREFERRED_PROVIDER_virtual/libusb0	 ?= "libusb-compat"
PREFERRED_PROVIDER_virtual/db-native	 ?= "db-native"
PREFERRED_PROVIDER_virtual/db		 ?= "db"
PREFERRED_PROVIDER_virtual/libx11	 ?= "libx11"
PREFERRED_PROVIDER_virtual/libgl	 ?= "mesa-xlib"
PREFERRED_PROVIDER_virtual/xserver	 ?= "xserver-kdrive"

PREFERRED_PROVIDER_avahi		 ?= "avahi"
PREFERRED_PROVIDER_gtk+			 ?= "gtk+"
PREFERRED_PROVIDER_lzo			 ?= "lzo2"
PREFERRED_PROVIDER_lzo-native		 ?= "lzo2-native"
PREFERRED_PROVIDER_u-boot		 ?= "u-boot"

PREFERRED_PROVIDER_virtual/kernel	  = "elito-kernel"

#
# C library
#
PREFERRED_PROVIDER_linux-libc-headers			= "linux-libc-headers"

#
# Bootstrap & Init
#
PREFERRED_PROVIDER_task-bootstrap = "task-bootstrap"

_devfs_init_provider_upstart = "${@elito_base_switch(d, 'IMAGE_DEV_MANAGER', \
	'udev', 'upstart-setup-udev', \
	'busybox-mdev', 'upstart-setup-mdev', \
	'MISSING-upstart-devfs-init')}"

_firmware_loader_provider_upstart = "${@elito_base_switch(d, 'IMAGE_DEV_MANAGER', \
	'udev', 'udev-firmware', \
	'busybox-mdev', 'busybox-mdev', \
	'MISSING-upstart-firmware-loader')}"

DEVFS_INIT_PROVIDER ?= "${@elito_base_switch(d, 'IMAGE_INIT_MANAGER', \
	'upstart', '${_devfs_init_provider_upstart}', \
	'MISSING-devfs-init')}"

FIRMWARE_LOADER_PROVIDER ?= "${@elito_base_switch(d, 'IMAGE_INIT_MANAGER', \
	'upstart', '${_firmware_loader_provider_upstart}', \
	'MISSING-firmware-loader')}"

#
# Misg
#
PREFERRED_PROVIDER_gconf ?= "gconf-dbus"

#
# Preferred versions
#

require conf/distro/include/elito-deps.inc
require conf/distro/include/elito-patches.inc
require conf/distro/include/elito-revs.inc
require conf/distro/include/elito-oldpkg.inc

require conf/distro/include/angstrom-ldflags.inc
require conf/distro/include/angstrom-${DISTRO_LIBC}.inc
```

## conf/distro/include/elito-deps.inc
```bitbake
# --*- python -*--
RRECOMMENDS_libasound_append	= " virtual/snd-device"
RRECOMMENDS_dropbear_append	= " virtual/dropbear-init"
RRECOMMENDS_tinylogin_append	= " virtual/tinylogin-init"
RRECOMMENDS_dbus_append		= " virtual/dbus-init elito-dbus-base"

RRECOMMENDS_kernel-module-rt73usb_append = " \
        wireless-tools rt73-firmware	\
        kernel-module-arc4 kernel-module-ecb kernel-module-cryptomgr"

RRECOMMENDS_rt73-firmware_append = " udev-firmware"

RRECOMMENDS_kernel-module-usb-storage_append = " kernel-module-sd-mod"

RRECOMMENDS_i2c-tools_append		= " kernel-module-i2c-dev"
RRECOMMENDS_udev-rules-base_append	= " udev-rules-ubi"
RRECOMMENDS_mtd-utils-ubi-tools_append	= " \
        mtd-utils-flash-tools mtd-utils-nand-tools"
```
