## meta/conf/distro/include/elito-oldpkg.inc
```bitbake
# --*- python -*--
#######################################

ELITO_OLD_CRUFT = "\
atk_1.30.0 \
bash_3.2.48 \
binutils_2.20.1 \
binutils_csl-arm-2008q1 \
binutils-cross_csl-arm-2008q1 \
binutils-cross_2.20.1 \
binutils-cross-canadian_2.20.1 \
binutils-crosssdk_2.20.1 \
bison_2.3 \
bluez4_4.82 \
cairo_1.10.0 \
connman_0.74 \
coreutils_6.9 \
cpio_2.8 \
diffutils_2.8.1 \
dosfstools_2.10 \
ed_0.5 \
findutils_4.2.31 \
gawk_3.1.5 \
gcc_csl-arm-2008q1 \
gcc-cross_csl-arm-2008q1 \
gcc-cross-initial_csl-arm-2008q1 \
gcc-cross-intermediate_csl-arm-2008q1 \
gettext_0.16.1 \
glib-2.0_2.27.5 \
gmp_4.2.1 \
gperf_3.0.3 \
grep_2.5.1a \
gtk+_2.12.7 \
gtk+_2.16.6 \
gzip_1.3.12 \
json-glib_0.10.4 \
libcanberra_0.26 \
libdrm_2.4.25 \
libgpg-error_1.8 \
libiconv_1.11.1 \
libidn_0.6.14 \
libx11_1.3.4 \
libxcb_1.1.91 \
m4_1.4.9 \
m4-native_1.4.9 \
matchbox-desktop_0.9.1 \
midori_0.2.9 \
mpfr_3.0.0 \
mtools_3.9.9 \
nfs-utils_1.1.2 \
openssl_0.9.8m \
openssl_0.9.8r \
pango_1.28.3 \
patch_2.5.9 \
pulseaudio_0.9.15 \
pulseaudio_0.9.22 \
readline_5.2 \
rsync_2.6.9 \
sed_4.1.2 \
tar_1.17 \
which_2.18 \
which_2.18 \
xserver-xorg_1.9.4 \
"

############################################

PKGDUP_IGNORES = " \
cross-localedef-native_2.12 \
eglibc_2.12 \
eglibc-initial_2.12 \
eglibc-locale_2.12 \
liberation-fonts_1.04 \
upstart-setup_devel \
"
```

## meta/conf/distro/include/elito-patches.inc
```bitbake
# --*- python -*--
# Due to the elito-directory.patch above
ALTERNATIVE_LINK_pn-iproute2 = "${base_sbindir}/ip"
```

## meta/conf/distro/include/elito-revs.inc
```bitbake
# --*- python -*--
LINUXLIBCVERSION		=  "${MACHINE_KERNEL_VERSION}"
UCLIBCVERSION			?= "git"
```

## meta/conf/layer.conf
```bitbake
# We have a conf and classes directory, add to BBPATH
BBPATH .= ":${LAYERDIR}"

ELITO_TOPDIR := "${@os.path.normpath('${LAYERDIR}/../')}"

BBFILES += "\
  ${LAYERDIR}/recipes/*/*.bb \
  ${LAYERDIR}/recipes/*/*.bbappend \
  ${LAYERDIR}/files/*/*.bbappend \
  ${@bb.utils.contains('BBFILE_COLLECTIONS','qt5-layer',\
      '${LAYERDIR}/recipes-qt5/*/*.bb \
       ${LAYERDIR}/recipes-qt5/*/*.bbappend','',d)} \
"

BBFILE_COLLECTIONS   += "elito"
BBFILE_PATTERN_elito := "^${LAYERDIR}/"
BBFILE_PRIORITY_elito =  "100"

FILESPATH_prepend := "${LAYERDIR}/files:"
FILESPATH_prepend  = '${FILESPATHBASE}'

SIGGEN_EXCLUDERECIPES_ABISAFE += "\
  elito-makefile \
"
```

## meta/conf/machine/cortex-m3.conf
```bitbake
#@TYPE: Machine
#@Name: Cortex M3
#@DESCRIPTION: Machine configuration for Cortex M3 Platforms

TARGET_ARCH		 = "arm"
TARGET_CPU		 = 'cortex-m3'
TARGET_ABI		 = "aapcs-linux"
TARGET_FPU		 = "soft"

MACHINE_FEATURES	?= "nokernel ${PROJECT_FEATURES}"

require conf/machine/include/tune-cortexm3.inc

SERIAL_CONSOLE		?= "115200 ttySA2"
DISTRO_LIBS		?= "uclibc"
EXTRA_OECONF_BASE	 = ""
```

## meta/conf/machine/kk-ipan4.conf
```bitbake
#@TYPE: Machine
#@Name: Keith & Koep iPAN4
#@DESCRIPTION: Machine configuration for Keith & Koep iPAN4

TARGET_ARCH		 = "arm"
TARGET_CPU		 = "arm926ej-s"
TARGET_ABI		 = "aapcs-linux"
TARGET_FPU		 = "softfp"

MACHINE_FEATURES	?= "barebox imx-bootlets mmc ${PROJECT_FEATURES}"
MACHINE_KERNEL_VERSION	?= "3.8"
KERNEL_BRANCH		?= "kk/ipan4"
KERNEL_DEFCONFIG	?= "kk-ipan4_defconfig"
KERNEL_IMAGETYPE	 = "uImage"
KERNEL_BOOT_VARIANT	 = "uboot"

UBOOT_VERSION		?= "v2013.03.0"
UBOOT_MACHINE		?= "${KERNEL_DEFCONFIG}"
UBOOT_BRANCH		?= "${KERNEL_BRANCH}"

FREESCALE_SBARCH	 = "imx28"
SOC_FAMILY		 = "mx28"

require conf/machine/include/tune-arm926ejs.inc
require conf/machine/include/soc-family.inc

SERIAL_CONSOLE		?= "115200 ttyAMA0"
EXTRA_OECONF_BASE	 = ""

TUNE_CCARGS := '${@"${TUNE_CCARGS}".replace("-mtune=", "-mcpu=")}'

EXTRA_IMAGEDEPENDS_append = " imx-bootlets elftosb"

ELITO_COMMON_MACHINE_CONFIGURATION ?= "conf/distro/include/elito-common_mx28.inc"
```

## meta/conf/machine/kk-trizeps4.conf
```bitbake
#@TYPE: Machine
#@Name: Keith & Koep Trizeps IV (PXA270)
#@DESCRIPTION: Machine configuration for Keith & Koep Trizeps IV (PXA270)

TARGET_ARCH		 = "arm"
#TARGET_CPU		 = 'iwmmxt'
TARGET_ABI		 = "aapcs-linux"
TARGET_FPU		 = "soft"

MACHINE_FEATURES	?= "iwmmxt jffs2 arnoldboot kdebug ${PROJECT_FEATURES}"
MACHINE_KERNEL_VERSION	?= "3.4"
KERNEL_BRANCH		?= "kk/trizeps4"
KERNEL_DEFCONFIG	?= "trizeps4_defconfig"
KERNEL_IMAGETYPE	 = "zImage"
KERNEL_BOOT_VARIANT	 = "arnoldboot"

MACHINE_DISPLAY_BPP		?= "16"
MACHINE_DISPLAY_WIDTH_PIXELS	?= "800"
MACHINE_DISPLAY_HEIGHT_PIXELS	?= "480"

RDEPENDS_kernel-base	 = ""

require conf/machine/include/tune-xscale.inc

SERIAL_CONSOLE		?= "115200 ttySA0"
EXTRA_OECONF_BASE	 = ""

FLASH_TOTALSIZE		?= "${@32*1024*1024}"
FLASH_ERASESIZE		?= "${@0x00040000}"

KERNEL_START_ADDRESS	?= "${@0xa0008000}"
KERNEL_OFFSET		?= "${@0x00080000}"
KERNEL_SIZE		?= "${@0x00240000}"

ROOTFS_OFFSET		?= "${@${KERNEL_OFFSET} + ${KERNEL_SIZE}}"
IMAGE_ROOTFS_SIZE	?= "${@${FLASH_TOTALSIZE} - ${ROOTFS_OFFSET}}"

EXTRA_IMAGECMD_jffs2	 =+ "--pad=${IMAGE_ROOTFS_SIZE} --little-endian --eraseblock=${FLASH_ERASESIZE}"

KERNEL_DEVICE_MEMORY	??= "64M"
KERNEL_ROOTFS		??= "root=/dev/mtdblock3 rootfstype=jffs2 rw"
KERNEL_CMDLINE_EXTRA	??= "user_debug=-1"
KERNEL_CMDLINE		  = "mem=${KERNEL_DEVICE_MEMORY} ${KERNEL_ROOTFS} console=${KERNEL_CONSOLE} ${KERNEL_CMDLINE_EXTRA}"

ELITO_COMMON_MACHINE_CONFIGURATION ?= "conf/distro/include/elito-common_pxa270.inc"
```

## meta/conf/machine/kk-trizeps6.conf
```bitbake
#@TYPE: Machine
#@Name: Keith & Koep Trizeps VI (Aspen PXA168)
#@DESCRIPTION: Machine configuration for Keith & Koep Trizeps VI (Aspen PXA168)

TARGET_ARCH		 = "arm"
#TARGET_CPU		 = 'iwmmxt'
TARGET_ABI		 = "aapcs-linux"
TARGET_FPU		 = "soft"

MACHINE_FEATURES	?= "iwmmxt ce-bootme ${PROJECT_FEATURES}"
MACHINE_KERNEL_VERSION	?= "3.4"
KERNEL_BRANCH		?= "kk/trizeps6"
KERNEL_DEFCONFIG	?= "trizeps6_defconfig"
KERNEL_IMAGETYPE	 = "zImage"
KERNEL_BOOT_VARIANT	 = "ceboot"

MACHINE_DISPLAY_BPP		?= "16"
MACHINE_DISPLAY_WIDTH_PIXELS	?= "800"
MACHINE_DISPLAY_HEIGHT_PIXELS	?= "480"

RDEPENDS_kernel-base	 = ""

MACHINE_EXTRA_RRECOMMENDS = "trizeps6-boot"
MACHINE_EXTRA_DEPENDS    = "trizeps6-boot ce-bootme-native"

require conf/machine/include/tune-xscale.inc

SERIAL_CONSOLE		?= "38400 ttySA0"
EXTRA_OECONF_BASE	 = ""

# TODO: fixme!
FLASH_ERASESIZE		?= "${@0x00040000}"

KERNEL_START_ADDRESS	?= "${@0x80008000}"
KERNEL_OFFSET		?= "${@0x00080000}"
KERNEL_SIZE		?= "${@0x00500000}"

ROOTFS_OFFSET		?= "${@${KERNEL_OFFSET} + ${KERNEL_SIZE}}"
IMAGE_ROOTFS_SIZE	?= "${@32*1024*1024 - ${ROOTFS_OFFSET}}"

EXTRA_IMAGECMD_jffs2	 =+ "--pad=$ROOTFS_SIZE --little-endian --eraseblock=${FLASH_ERASESIZE}"

ELITO_COMMON_MACHINE_CONFIGURATION ?= "conf/distro/include/elito-common_pxa168.inc"
```

## meta/conf/machine/kk-trizeps7.conf
```bitbake
#@TYPE: Machine
#@Name: Keith & Koep Trizeps VII (i.MX6)
#@DESCRIPTION: Machine configuration for Keith & Koep Trizeps VII (i.MX6)

DEFAULTTUNE = "cortexa9thf-neon"

include conf/include/elito-imx.inc
include conf/machine/include/tune-cortexa9.inc

SOC_FAMILY = "mx6"

MACHINE_FEATURES_HW	?= "wm9715"
MACHINE_FEATURES	+= "barebox mmc ${MACHINE_FEATURES_HW}"
MACHINE_KERNEL_VERSION	?= "3.14"
KERNEL_BRANCH		?= "kk/trizeps7"
KERNEL_DEFCONFIG	?= "kk-trizeps7_defconfig"
KERNEL_IMAGETYPE	 = "zImage"

MACHINE_VARIANTS	?= "trizeps7q:mx6q:1gib"
MACHINE_VARIANTS[type]	 = "list"
MACHINE_VARIANTS[doc]	 = "\
The Trizeps 7 module types; it is a list where each element is a ':' \
delimited triple where the first part specifies the generic, non-unique \
name of the module, the second part the SOC family and last one the \
equipped memory. \
\
ATM, only 'trizeps7q:mx6q:1gib' is supported"

UBOOT_VERSION		?= "v2014.06.0"
UBOOT_MACHINE		?= "kk_trizeps7_defconfig"
UBOOT_BRANCH		?= "kk/trizeps7"
UBOOT_BOARD		?= "kk-trizeps7"

SERIAL_CONSOLE		 = "115200 ttymxc1"

require conf/machine/include/soc-family.inc

ELITO_COMMON_MACHINE_CONFIGURATION ?= "conf/distro/include/elito-common_mx6.inc"


#### TODO: move into own dedicated file!
MACHINE_SOCARCH_mx6	 = "${TUNE_PKGARCH}-mx6"
```

## meta/conf/machine/omap-beagle.conf
```bitbake
#@TYPE: Machine
#@Name: Phytec PCM034
#@DESCRIPTION: Machine configuration for OMAP Beagle Platform

TARGET_ARCH		 = "arm"
TARGET_CPU		 = 'cortex-a8'
TARGET_ABI		 = "aapcs-linux"
TARGET_FPU		 = "soft"

MACHINE_FEATURES	?= "${PROJECT_FEATURES}"
MACHINE_KERNEL_VERSION	?= "2.6.33"
KERNEL_BRANCH		?= "omap/beagle"
KERNEL_DEFCONFIG	?= "omap_beagle_defconfig"
KERNEL_IMAGETYPE	 = "uImage"

UBOOT_VERSION		?= "2009.11"
UBOOT_MACHINE		?= "omap3_beagle_config"
UBOOT_BRANCH		?= "omap/beagle"

require conf/machine/include/tune-cortexa8.inc

SERIAL_CONSOLE		?= "115200 ttySA2"
EXTRA_OECONF_BASE	 = ""
```

## meta/conf/machine/phycore-mx6.conf
```bitbake
#@TYPE: Machine
#@Name: Phytec PhyCore (i.MX6)
#@DESCRIPTION: Machine configuration for Phytec PhyCore (i.MX6)

DEFAULTTUNE = "cortexa9thf-neon"

include conf/machine/include/tune-cortexa9.inc

SOC_FAMILY = "mx6"

MACHINE_FEATURES_HW	?= "fb captouch"
MACHINE_FEATURES	+= "barebox nand mtd ${MACHINE_FEATURES_HW}"
MACHINE_KERNEL_VERSION	?= "4.1"
KERNEL_BRANCH		?= "imx6"
KERNEL_DEFCONFIG	?= "file://phycore-mx6_defconfig"
KERNEL_IMAGETYPE	 = "zImage"

MACHINE_VARIANTS	?= "\
	phycore-mx6q:mx6q:1gib \
	phycore-mx6q:mx6q:2gib \
"

MACHINE_VARIANTS[type]	 = "list"
MACHINE_VARIANTS[doc]	 = "\
The Phytec PhyCore platform types; it is a list where each element is a ':' \
delimited triple where the first part specifies the generic, non-unique \
name of the module, the second part the SOC family and last one the \
equipped memory."

UBOOT_VERSION		?= "v2015.11"
UBOOT_MACHINE		?= "phycore-mx6_defconfig"
UBOOT_BRANCH		?= "phytec/phycore-mx6"
UBOOT_BOARD		?= "phytec-som-imx6"

MX6_LOAD_BRANCH		?= "phytec/phycore-mx6"

SERIAL_CONSOLE		 = "115200 ttymxc1"

require conf/machine/include/soc-family.inc

ELITO_COMMON_MACHINE_CONFIGURATION ?= "conf/distro/include/elito-common_mx6.inc"


#### TODO: move into own dedicated file!
MACHINE_SOCARCH_mx6	 = "${TUNE_PKGARCH}-mx6"

include conf/include/elito-imx.inc

MACHINEOVERRIDES        =. "${MACHINEOVERRIDES_EXTENDER_mx6qdl}:"
```

## meta/conf/machine/phytec-pca101.conf
```bitbake
#@TYPE: Machine
#@Name: Phytec PhyCard-M (PCA101)
#@DESCRIPTION: Machine configuration for Phytec PhyCard-M (PCA101)

TARGET_ARCH		 = "arm"
TARGET_CPU		 = 'arm1136jf-s'
TARGET_ABI		 = "aapcs-linux"

MACHINE_FEATURES	?= "jffs2 mtd barebox kdebug ${PROJECT_FEATURES}"
MACHINE_KERNEL_VERSION	?= "2.6.33"
KERNEL_BRANCH		?= "phytec/pca101"
KERNEL_DEFCONFIG	?= "pca101_defconfig"
KERNEL_IMAGETYPE	 = "uImage"
KERNEL_BOOT_VARIANT	 = "uboot"

UBOOT_VERSION		?= "2010.10.0"
UBOOT_MACHINE		?= "pca101_defconfig"
UBOOT_BRANCH		?= "phytec/pca101"

require conf/machine/include/tune-arm1136jf-s.inc

SERIAL_CONSOLE		?= "115200 ttymxc0"
EXTRA_OECONF_BASE	 = ""

TUNE_CCARGS := '${@"${TUNE_CCARGS}".replace("-mtune=", "-mcpu=")}'

FLASH_ERASESIZE		?= "${@0x00020000}"

EXTRA_IMAGECMD_jffs2 =+ "\
  --little-endian \
  --eraseblock=${FLASH_ERASESIZE} \
  --no-cleanmarkers \
"

ELITO_COMMON_MACHINE_CONFIGURATION ?= "conf/distro/include/elito-common_mx35.inc"
```

## meta/conf/machine/phytec-pca102.conf
```bitbake
#@TYPE: Machine
#@Name: Phytec PhyCard-L (PCA102)
#@DESCRIPTION: Machine configuration for Phytec PhyCard-L (PCA102)

TARGET_ARCH		 = "arm"
TARGET_CPU		 = 'cortex-a8'
TARGET_ABI		 = "aapcs-linux"

#DEFAULTTUNE		 = "cortexa8-neon"
#TUNE_FEATURES_append    = " no-thumb-interwork"

SOC_FAMILY		 = "omap3"

MACHINE_FEATURES_HW	?= "wm9715"
MACHINE_FEATURES	+= "mtd barebox ${MACHINE_FEATURES_HW}"
MACHINE_KERNEL_VERSION	?= "3.2"
KERNEL_BRANCH		?= "phytec/pca102"
KERNEL_DEFCONFIG	?= "pca102_defconfig"
KERNEL_IMAGETYPE	 = "zImage"

UBOOT_VERSION		?= "2012.03.0"
UBOOT_MACHINE		?= "phycard_a_l1_defconfig"
UBOOT_BRANCH		?= "phytec/pca102"

require conf/machine/include/tune-cortexa8.inc
require conf/machine/include/soc-family.inc

SERIAL_CONSOLE		?= "115200 ttyO2"
EXTRA_OECONF_BASE	 = ""

TUNE_CCARGS := '${@"${TUNE_CCARGS}".replace("-mtune=", "-mcpu=")}'

FLASH_ERASESIZE		?= "${@0x00020000}"

EXTRA_IMAGECMD_jffs2 =+ "\
  --little-endian \
  --eraseblock=${FLASH_ERASESIZE} \
  --no-cleanmarkers \
"

ELITO_COMMON_MACHINE_CONFIGURATION ?= "conf/distro/include/elito-common_omap3.inc"
```

## meta/conf/machine/phytec-pcm037.conf
```bitbake
#@TYPE: Machine
#@Name: Freescale MX31ADS
#@DESCRIPTION: Machine configuration for Freescale MX31ADS

TARGET_ARCH		 = "arm"
TARGET_CPU		 = "arm1136jf-s"
TARGET_ABI		 = "aapcs-linux"
TARGET_FPU		 = "softfp"

MACHINE_FEATURES        ?= "pcmcia usbhost usbgadget ${PROJECT_FEATURES}"
MACHINE_KERNEL_VERSION	?= "2.6.22"
KERNEL_BRANCH		?= "phytec/pcm037"
KERNEL_DEFCONFIG	?= "pcm037_defconfig"
KERNEL_IMAGETYPE	 = "uImage"

UBOOT_MACHINE		?= "pcm037_config"
UBOOT_BRANCH		?= "phytec/pcm037"

EXTRA_IMAGECMD_jffs2	=+ "--pad --little-endian --eraseblock=131072"

require conf/machine/include/tune-arm1136jf-s.inc
TARGET_CC_ARCH		 = ""

# used by sysvinit_2
SERIAL_CONSOLE		?= "115200 ttymxc0"

# used by opie-collections.inc
ROOT_FLASH_SIZE		 = "32"
```

## meta/conf/machine/phytec-pcm043.conf
```bitbake
#@TYPE: Machine
#@Name: Freescale MX31ADS
#@DESCRIPTION: Machine configuration for Freescale MX31ADS

TARGET_ARCH		 = "arm"
TARGET_CPU		 = "arm1136jf-s"
TARGET_ABI		 = "aapcs-linux"
TARGET_FPU		 = "softfp"

MACHINE_FEATURES        ?= "usbhost ${PROJECT_FEATURES}"
MACHINE_KERNEL_VERSION	?= "2.6.33"
KERNEL_BRANCH		?= "phytec/pcm043"
KERNEL_DEFCONFIG	?= "pcm043_defconfig"
KERNEL_IMAGETYPE	 = "uImage"

UBOOT_MACHINE		?= "pcm043_config"
UBOOT_BRANCH		?= "phytec/pcm037"

EXTRA_IMAGECMD_jffs2	=+ "--pad --little-endian --eraseblock=131072"

require conf/machine/include/tune-arm1136jf-s.inc

# used by sysvinit_2
SERIAL_CONSOLE		?= "115200 ttymxc0"

# used by opie-collections.inc
ROOT_FLASH_SIZE		 = "32"
```

## meta/conf/machine/phytec-phyflex-mx6.conf
```bitbake
#@TYPE: Machine
#@Name: Phytec PhyFlex (i.MX6)
#@DESCRIPTION: Machine configuration for Phytec PhyFlex (i.MX6)

DEFAULTTUNE = "cortexa9thf-neon"

include conf/machine/include/tune-cortexa9.inc

SOC_FAMILY = "mx6"

MACHINE_FEATURES_HW	?= "fb captouch"
MACHINE_FEATURES	+= "barebox mmc mtd ${MACHINE_FEATURES_HW}"
MACHINE_KERNEL_VERSION	?= "4.0"
KERNEL_BRANCH		?= "imx6"
KERNEL_DEFCONFIG	?= "file://phytec-phyflex-mx6_defconfig"
KERNEL_IMAGETYPE	 = "zImage"

MACHINE_VARIANTS	?= "phyflex-imx6q:mx6q:1gib \
			    phyflex-imx6q:mx6q:1gib-1bank \
			    phyflex-imx6q:mx6q:4gib \
			    phyflex-imx6dl:mx6dl:1gib \
			    phyflex-imx6dl:mx6dl:1gib-1bank"

MACHINE_VARIANTS[type]	 = "list"
MACHINE_VARIANTS[doc]	 = "\
The PhyFlex module types; it is a list where each element is a ':' \
delimited triple where the first part specifies the generic, non-unique \
name of the module, the second part the SOC family and last one the \
equipped memory."

UBOOT_VERSION		?= "v2015.02"
UBOOT_MACHINE		?= "phytec-phyflex-mx6_defconfig"
UBOOT_BRANCH		?= "phytec/phyflex-mx6"
UBOOT_BOARD		?= "phytec-phyflex-imx6"

MX6_LOAD_BRANCH		?= "phytec/pfla02"
SRCREV_pn-elito-mx6-load ??= "d1557bdde0632c2409fc651db9328a6cc2d30636"

SERIAL_CONSOLE		 = "115200 ttymxc3"

require conf/machine/include/soc-family.inc

ELITO_COMMON_MACHINE_CONFIGURATION ?= "conf/distro/include/elito-common_mx6.inc"


#### TODO: move into own dedicated file!
MACHINE_SOCARCH_mx6	 = "${TUNE_PKGARCH}-mx6"

include conf/include/elito-imx.inc
```
