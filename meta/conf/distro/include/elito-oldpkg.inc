## meta/conf/machine/toradex-colibri270.conf
```bitbake
#@TYPE: Machine
#@Name: Toradex Colibri320 PXA270
#@DESCRIPTION: Machine configuration for Toradex Colibri270 PXA320 Platform

TARGET_ARCH		 = "arm"
#TARGET_CPU		 = "iwmmxt"
TARGET_ABI		 = "aapcs-linux"
TARGET_FPU		 = "soft"

MACHINE_FEATURES_HW	?= "pcmcia sja1100 wm9715 ucb1400"
MACHINE_FEATURES	+= "iwmmxt mtd jffs2 u-boot ${PROJECT_FEATURES}"
MACHINE_KERNEL_VERSION	?= "3.4"
KERNEL_BRANCH		?= "toradex/colibri270"
KERNEL_DEFCONFIG	?= "colibri270_defconfig"
KERNEL_IMAGETYPE	 = "uImage"
KERNEL_BOOT_VARIANT	 = "uboot"

UBOOT_VERSION		?= "2010.06"
UBOOT_MACHINE		?= "colibri270_config"
UBOOT_BRANCH		?= "toradex/colibri270"

MACHINE_DISPLAY_BPP		?= "24"
MACHINE_DISPLAY_WIDTH_PIXELS	?= "640"
MACHINE_DISPLAY_HEIGHT_PIXELS	?= "480"

RDEPENDS_kernel-base	 = ""

require conf/machine/include/tune-xscale.inc

SERIAL_CONSOLE		?= "115200 ttySA0"
EXTRA_OECONF_BASE	 = ""

FLASH_ERASESIZE		?= "${@0x00020000}"

KERNEL_OFFSET		?= "${@0x00080000}"
KERNEL_SIZE		?= "${@0x00240000}"

ROOTFS_OFFSET		?= "${@${KERNEL_OFFSET} + ${KERNEL_SIZE}}"
IMAGE_ROOTFS_SIZE	?= "${@32*1024*1024 - ${ROOTFS_OFFSET}}"

EXTRA_IMAGECMD_jffs2	 =+ "--pad=$ROOTFS_SIZE --little-endian --eraseblock=${FLASH_ERASESIZE}"

KERNEL_CMDLINE		?=  "root=/dev/mtdblock3 rw rootfstype=jffs2 console=${KERNEL_CONSOLE}"

ELITO_COMMON_MACHINE_CONFIGURATION ?= "conf/distro/include/elito-common_pxa270.inc"
```

## meta/conf/machine/toradex-colibri320.conf
```bitbake
#@TYPE: Machine
#@Name: Toradex Colibri320 PXA320
#@DESCRIPTION: Machine configuration for Toradex Colibri320 PXA320 Platform

TARGET_ARCH		 = "arm"
#TARGET_CPU		 = "iwmmxt"
TARGET_ABI		 = "aapcs-linux"
TARGET_FPU		 = "soft"

MACHINE_FEATURES	?= "iwmmxt kernel26 kdebug ubifs mtd mobm320 u-boot ${PROJECT_FEATURES}"
MACHINE_KERNEL_VERSION	?= "3.2"
KERNEL_BRANCH		?= "toradex/colibri320"
KERNEL_DEFCONFIG	?= "colibri320_defconfig"
KERNEL_IMAGETYPE	 = "uImage"
KERNEL_BOOT_VARIANT	 = "uboot"

UBOOT_VERSION		?= "2010.06"
UBOOT_MACHINE		?= "colibri320_config"
UBOOT_BRANCH		?= "toradex/colibri320"

NAND_PAGESIZE		 =       "2048"
NAND_BLOCKSIZE		 =     "131072"
FLASH_SIZE		 = "1073741824"

MACHINE_DISPLAY_BPP		?= "24"
MACHINE_DISPLAY_WIDTH_PIXELS	?= "640"
MACHINE_DISPLAY_HEIGHT_PIXELS	?= "480"

RDEPENDS_kernel-base	 = ""

MOBM320_IMAGE		?= "mobm-colibri320-1.2"
MOBM320_ENV_ARGS	?= '--serial 0x001122334455'

UBOOT_SIZE		?= "${@0x00020000}"
KERNEL_SIZE		?= "${@0x00240000}"
IMAGE_ROOTFS_SIZE	?= "52428800"
UBI_VOLUMES		?= "\
	kernel		static	${KERNEL_IMAGETYPE}-${MACHINE}.bin	${KERNEL_SIZE},	\
	bootenv		static	${IMAGE_NAME}.rootfs.bootenv	16384,		\
	bootloader	static	u-boot-${MACHINE}.bin		${UBOOT_SIZE},	\
	rootfs		dynamic	${IMAGE_NAME}.rootfs.ubifs	${IMAGE_ROOTFS_SIZE}	\
"

require conf/machine/include/tune-xscale.inc

SERIAL_CONSOLE		?= "115200 ttySA1"
EXTRA_OECONF_BASE	 = ""

KERNEL_CMDLINE		?= "ubi.mtd=UBI root=ubi0:rootfs rootfstype=ubifs console=${KERNEL_CONSOLE}"

ELITO_COMMON_MACHINE_CONFIGURATION ?= "conf/distro/include/elito-common_pxa320.inc"
```

## meta/conf/machine/tq-mx28.conf
```bitbake
#@TYPE: Machine
#@Name: TQ STKa28
#@DESCRIPTION: Machine configuration for TQ STKa28

TARGET_ARCH		 = "arm"
TARGET_CPU		 = "arm926ej-s"
TARGET_ABI		 = "aapcs-linux"
TARGET_FPU		 = "softfp"

MACHINE_FEATURES	?= "kdebug barebox imx-bootlets ${PROJECT_FEATURES}"
MACHINE_KERNEL_VERSION	?= "3.1"
KERNEL_BRANCH		?= "tq/mx28"
KERNEL_DEFCONFIG	?= "tq_stka28_defconfig"
KERNEL_IMAGETYPE	 = "uImage"
KERNEL_BOOT_VARIANT	 = "uboot"

UBOOT_VERSION		?= "v2011.10"
UBOOT_MACHINE		?= "${KERNEL_DEFCONFIG}"
UBOOT_BRANCH		?= "${KERNEL_BRANCH}"

FREESCALE_SBARCH	 = "imx28"

require conf/machine/include/tune-arm926ejs.inc

SERIAL_CONSOLE		?= "115200 ttyAMA0"
EXTRA_OECONF_BASE	 = ""

TUNE_CCARGS := '${@"${TUNE_CCARGS}".replace("-mtune=", "-mcpu=")}'

EXTRA_IMAGEDEPENDS_append = " imx-bootlets elftosb"

ELITO_COMMON_MACHINE_CONFIGURATION ?= "conf/distro/include/elito-common_mx28.inc"
```

## meta/conf/machine/tq-tqma6x.conf
```bitbake
#@TYPE: Machine
#@Name: TQ TQMa6x
#@DESCRIPTION: Machine configuration for TQ TQMa6x (i.MX6)

DEFAULTTUNE = "cortexa9thf-neon"

include conf/machine/include/tune-cortexa9.inc

SOC_FAMILY = "mx6"

MACHINE_FEATURES_HW	?= ""
MACHINE_FEATURES	+= "mmc ${MACHINE_FEATURES_HW}"
MACHINE_KERNEL_VERSION	?= "3.16"
KERNEL_BRANCH		?= "tq/tqma6x"
KERNEL_DEFCONFIG	?= "tq-tqma6x_defconfig"
KERNEL_IMAGETYPE	 = "zImage"

MACHINE_VARIANTS	?= "tqma6s:mx6s:1gib"
MACHINE_VARIANTS[type]	 = "list"
MACHINE_VARIANTS[doc]	 = "\
The TQMa6 module types; it is a list where each element is a ':' \
delimited triple where the first part specifies the generic, non-unique \
name of the module, the second part the SOC family and last one the \
equipped memory. \
\
ATM, only 'tqma6s:mx6s:1gib' is supported"

UBOOT_VERSION		?= "v2014.06.0"
UBOOT_MACHINE		?= "kk_trizeps7_defconfig"
UBOOT_BRANCH		?= "kk/trizeps7"
UBOOT_BOARD		?= "kk-trizeps7"

SERIAL_CONSOLE		 = "115200 ttymxc1"

require conf/machine/include/soc-family.inc

ELITO_COMMON_MACHINE_CONFIGURATION ?= "conf/distro/include/elito-common_mx6.inc"


#### TODO: move into own dedicated file!
MACHINE_SOCARCH_mx6	 = "${TUNE_PKGARCH}-mx6"

include conf/include/elito-imx.inc
```

## meta/conf/machine/x86-nehalem-64.conf
```bitbake
TARGET_ARCH		 = "x86_64"
TRANSLATED_TARGET_ARCH	 = "x86-64"
MACHINE_ARCH		 = "x86-nehalem-64"

DEFAULTTUNE		?= "corei7-64"

MACHINE_DRI_MODULES	?= "i915,i965"
MACHINE_FEATURES	 = "screen keyboard pci usbhost ext3 x86_64 acpi ${PROJECT_FEATURES}"
MACHINE_KERNEL_VERSION	?= "2.6.38"
KERNEL_BRANCH		?= "nehalem64"
KERNEL_DEFCONFIG	?= "nehalem64_defconfig"
KERNEL_IMAGETYPE	 = "bzImage"

GLIBC_ADDONS		 = "nptl,libidn"
GLIBC_EXTRA_OECONF	 = "--with-tls"

require conf/machine/include/tune-corei7.inc

KERNEL_CONSOLE		?= ""

OVERRIDES_append	 = ":x86-64"

PACKAGE_EXTRA_ARCHS     ?= "${TARGET_ARCH}"
```

## meta/conf/machine/zynq-7000.conf
```bitbake
#@TYPE: Machine
#@Name: Xilinx Zynq
#@DESCRIPTION: Machine configuration for Xilinx Zynq

DEFAULTTUNE		 = "cortexa9thf-neon"

include conf/machine/include/tune-cortexa9.inc

MACHINE_FEATURES_HW	?= ""
MACHINE_FEATURES	+= "u-boot ${MACHINE_FEATURES_HW}"

MACHINE_KERNEL_VERSION	?= "3.14"
KERNEL_BRANCH		?= "xilinx/zynq-7000"
KERNEL_DEFCONFIG	?= "zynq_defconfig"
KERNEL_IMAGETYPE	 = "uImage"
KERNEL_BOOT_VARIANT	 = "uboot"
KERNEL_LOADADDR		?= "0x00008000"

UBOOT_VERSION		?= "2012.10"
UBOOT_MACHINE		?= "zynq_defconfig"
UBOOT_BRANCH		?= "xilinx/zynq-7000"

SERIAL_CONSOLE		?= "115200 ttyPS0"

ELITO_COMMON_MACHINE_CONFIGURATION ?= "conf/distro/include/elito-common_zynq.inc"
```
